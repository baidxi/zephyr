## soc/allwinner/sun8i_t113s3/Kconfig.defconfig
```kconfig
# Copyright (c) 2026 jeck chen <baidxi404629@gmail.com>
# SPDX-License-Identifier: Apache-2.0

if SOC_SUN8I_T113S3

config NUM_IRQS
	default 192

config SYS_CLOCK_HW_CYCLES_PER_SEC
	default $(dt_node_int_prop_int,/timer,clock-frequency)

# The SoC-level MMU region table (soc.c) maps the full 128 MB DDR
# region with 4 kB pages.  arm_mmu.c never uses 1 MB sections for the
# mmu_config regions, so that one entry alone needs 128 L2 tables,
# plus a handful for the device MMIO regions (GIC/UART/CCU/PIO/timer).
# The arch default of 64 is far too small: once exhausted the L2 pool
# silently reuses one table and corrupts every later device mapping,
# which is exactly why the console UART dies after z_arm_mmu_init().
config ARM_MMU_NUM_L2_TABLES
	default 140

# The SoC exposes a CCU reset controller (the ccu_reset child node of
# the CCU) consumed by peripherals such as the UART.  Enable the reset
# subsystem so reset_line_toggle() works; without it the ns16550 driver
# aborts its init on "UART toggle reset line failed" (-ENOSYS) and the
# shell backend can never attach to the console UART.
config RESET
	default y

# Enable PM_DEVICE so the ns16550 driver fully configures the UART
# (baud-rate divisor, LCR, FCR, …) via its PM action callback during
# init.  pm_device_driver_init() always invokes PM_DEVICE_ACTION_TURN_ON
# (which calls uart_ns16550_configure()), but with PM_DEVICE enabled the
# driver also gets the full runtime PM state machine.  This keeps the
# console UART correctly configured regardless of the reset path used.
config PM_DEVICE
	default y

if SERIAL

config UART_NS16550
	default y

config UART_NS16550_DW8250_DW_APB
	default y

config UART_NS16550_ACCESS_WORD_ONLY
	default y

endif # SERIAL

endif
```

## soc/allwinner/sun8i_t113s3/Kconfig.soc
```kconfig
# Copyright (c) 2026 jeck chen <baidxi404629@gmail.com>
# SPDX-License-Identifier: Apache-2.0

config SOC_SUN8I_T113S3
	bool

config SOC
	default "sun8i_t113s3" if SOC_SUN8I_T113S3

if SOC_SUN8I_T113S3

config T113_EARLY_PRINTK
	bool "Early UART printk (T113-S3)"
	help
	  Route printk() output through a bare-metal UART driver before the
	  Zephyr console subsystem is initialised.  The bootloader (SPL) must
	  have already configured the selected UART (pins, baud rate, etc.).

	  This is equivalent to Linux early_printk and useful for debugging
	  early boot failures (clock, MMU, pinctrl).

if T113_EARLY_PRINTK

choice T113_EARLY_PRINTK_UART
	prompt "Early printk UART"
	default T113_EARLY_PRINTK_UART3
	help
	  Select which UART to use for early printk output.
	  Must match the UART that the bootloader configured.

config T113_EARLY_PRINTK_UART0
	bool "UART0 (0x02500000)"

config T113_EARLY_PRINTK_UART1
	bool "UART1 (0x02500400)"

config T113_EARLY_PRINTK_UART2
	bool "UART2 (0x02500800)"

config T113_EARLY_PRINTK_UART3
	bool "UART3 (0x02500C00)"

config T113_EARLY_PRINTK_UART4
	bool "UART4 (0x02501000)"

config T113_EARLY_PRINTK_UART5
	bool "UART5 (0x02501400)"

endchoice

endif # T113_EARLY_PRINTK

endif # SOC_SUN8I_T113S3
```

## soc/allwinner/sun8i_v3s/Kconfig
```kconfig
# Copyright (c) 2025
# SPDX-License-Identifier: Apache-2.0

config SOC_SUN8I_V3S
	bool
	select SOC_SERIES_SUN8I
	select ARM
	select CPU_CORTEX_A7
	select ARM_ARCH_TIMER
	select SYS_CLOCK_EXISTS
	select SOC_FAMILY_ARM
	select SOC_RESET_HOOK
```

## soc/allwinner/sun8i_v3s/Kconfig.soc
```kconfig
# Copyright (c) 2025
# SPDX-License-Identifier: Apache-2.0

config SOC_SUN8I_V3S
	bool

config SOC
	default "sun8i_v3s" if SOC_SUN8I_V3S
```

## subsys/logging/backends/Kconfig.ramlog
```kconfig
# Copyright (c) 2025
# SPDX-License-Identifier: Apache-2.0

config LOG_BACKEND_RAM
	bool "RAM log backend"
	select LOG_OUTPUT
	help
	  Store formatted log messages in a RAM ring buffer for later
	  retrieval via shell commands (log show, log clean).

	  This backend is useful for debugging when no UART/RTT/network
	  is available, or when you need to inspect recent logs after
	  a connection has been lost. Log messages are stored as
	  formatted text, identical to what would appear on a UART
	  console.

if LOG_BACKEND_RAM

config LOG_BACKEND_RAM_BUF_SIZE
	int "RAM log buffer size in bytes"
	default 4096
	range 256 65536
	help
	  Size of the ring buffer used to store formatted log output.

	  This is separate from CONFIG_LOG_BUFFER_SIZE, which stores
	  raw binary log_msg packets in deferred mode. Formatted text
	  output is typically 1.5-3x larger than the raw binary package,
	  so this buffer should be sized accordingly.

config LOG_BACKEND_RAM_OUTPUT_BUF_SIZE
	int "RAM backend internal scratch buffer size"
	default 256
	range 64 1024
	help
	  Internal formatting buffer for log_output. This is NOT the
	  storage buffer where log messages are kept. It is used as a
	  scratch buffer during message formatting.

config LOG_BACKEND_RAM_AUTOSTART
	bool "Auto-start RAM log backend"
	default y
	help
	  Automatically enable RAM logging at boot. When disabled, use
	  'log backend ram go' in shell to activate.

backend = RAM
backend-str = ram
source "subsys/logging/Kconfig.template.log_format_config"

endif # LOG_BACKEND_RAM
```

## subsys/usb/device_next/Kconfig
```kconfig
# Copyright (c) 2022 Nordic Semiconductor ASA
#
# SPDX-License-Identifier: Apache-2.0

menuconfig USB_DEVICE_STACK_NEXT
	bool "New USB device stack"
	select UDC_DRIVER
	imply HWINFO
	help
	  New USB device stack.

if USB_DEVICE_STACK_NEXT

module = USBD
module-str = usbd
source "subsys/logging/Kconfig.template.log_config"

choice USBD_MAX_SPEED_CHOICE
	prompt "Max supported connection speed"
	default USBD_MAX_SPEED_HIGH if UDC_DRIVER_HAS_HIGH_SPEED_SUPPORT
	default USBD_MAX_SPEED_FULL

config USBD_MAX_SPEED_HIGH
	bool "High-Speed"
	depends on UDC_DRIVER_HAS_HIGH_SPEED_SUPPORT

config USBD_MAX_SPEED_FULL
	bool "Full-Speed"
	depends on !UDC_DRIVER_HIGH_SPEED_SUPPORT_ENABLED

endchoice

config USBD_MAX_SPEED
	int
	default 0 if USBD_MAX_SPEED_FULL
	default 1 if USBD_MAX_SPEED_HIGH

config USBD_BOS_SUPPORT
	bool "USB device BOS support"
	default y
	help
	  BOS support can be disabled if the application does not use a BOS
	  descriptor.

config USBD_VREQ_SUPPORT
	bool "USB device vendor request support"
	default y
	help
	  Allow the application to register a handler for the vendor request
	  with the recipient device.

config USBD_COMPOSITE_DEVICE
	bool "USB Composite Device support"
	help
	  Enable composite device support. When enabled, multiple USB class
	  instances registered to the same configuration are organized into
	  function groups, each preceded by an IAD (Interface Association
	  Descriptor) in the configuration descriptor.

	  When enabled and multiple functions are selected, the device
	  descriptor class code should be set to Miscellaneous (0xEF) with
	  subclass 2 and protocol 1. Use usbd_device_set_code_triple() to
	  configure this at runtime.

	  Endpoint requirements for common functions (excluding EP0):
	  - CDC ACM: 3 ep (1 INT IN, 1 BULK IN, 1 BULK OUT)
	  - CDC ECM / NCM: 3 ep (1 INT IN, 1 BULK IN, 1 BULK OUT)
	  - MSC: 2 ep (1 BULK IN, 1 BULK OUT)
	  - HID: 1-2 ep (1 INT IN, optionally 1 INT OUT)
	  - UVC: 2-3 ep
	  - UAC2: 2-4 ep
	  - MIDI2: 2 ep (1 BULK IN, 1 BULK OUT)
	  - DFU (runtime): 0 ep
	  - Loopback: 2 ep (1 BULK IN, 1 BULK OUT)

	  Endpoint counts are combined when multiple functions are selected.
	  Runtime validation during init will fail with an error if the MCU
	  lacks sufficient endpoints. Check the MCU datasheet or DTS
	  'num_bidir_endpoints' property for the available count.

config USBD_SHELL
	bool "USB device shell"
	depends on SHELL
	help
	  Enable USB device shell.

config USBD_THREAD_INIT_PRIO
	int
	default 90
	help
	  USB device thread initialization priority level.

config USBD_THREAD_STACK_SIZE
	int "USB device stack thread stack size"
	default 1024
	help
	  USB device stack thread stack size in bytes.

config USBD_MAX_UDC_MSG
	int "Maximum number of UDC events"
	default 10
	help
	  Maximum number of USB device controller events that can be queued.

config USBD_MSG_DEFERRED_MODE
	bool "Execute message callback from system workqueue"
	default y
	help
	  Execute message callback from system workqueue. If disabled, message
	  callback will be executed in the device stack context.

config USBD_MSG_SLAB_COUNT
	int "Maximum number of USB device notification messages" if USBD_MSG_DEFERRED_MODE
	range 4 64
	default 8
	help
	  Maximum number of USB device notification messages that can be queued.

config USBD_MSG_WORK_DELAY
	int "USB device notification messages work delay" if USBD_MSG_DEFERRED_MODE
	range 1 100
	default 1
	help
	  Message work may need to be delayed because the device stack is not
	  yet ready to publish the message. The delay unit is milliseconds.

config USBD_HWINFO_DEVID_LENGTH
	int "The length of the device ID requested from HWINFO in bytes" if HWINFO
	range 8 128
	default 16
	help
	  Each byte represents two digits in the serial number string
	  descriptor. This option can be used to limit the length requested
	  from HWINFO to a meaningful number of digits.

rsource "class/Kconfig"
rsource "app/Kconfig.cdc_acm_serial"
rsource "app/Kconfig.usbd_fastbootd"

endif # USB_DEVICE_STACK_NEXT
```

## subsys/usb/device_next/app/Kconfig.usbd_fastbootd
```kconfig
# Copyright (c) 2024 juno <baidxi404629@gmail.com>
#
# SPDX-License-Identifier: Apache-2.0

config USBD_FASTBOOTD
	bool "USB Bootloader composite device (CDC ACM + Fastboot)"
	help
	  Automatically initializes a composite USB device with CDC ACM
	  and Fastboot classes via SYS_INIT. Use this for bootloader
	  applications that need serial console and firmware update
	  over USB.

if USBD_FASTBOOTD

config USBD_FASTBOOTD_VID
	hex "USB Vendor ID"
	default 0x2FE3

config USBD_FASTBOOTD_PID
	hex "USB Product ID"
	default 0x1001

config USBD_FASTBOOTD_MANUFACTURER_STRING
	string "Manufacturer string"
	default "ART-Pi2"

config USBD_FASTBOOTD_PRODUCT_STRING
	string "Product string"
	default "ART-Pi2 Bootloader"

config USBD_FASTBOOTD_MAX_POWER
	int "Max power (2mA units)"
	default 250
	range 0 500

config USBD_FASTBOOTD_SELF_POWERED
	bool "Self-powered"
	default n

endif
```

## subsys/usb/host/class/Kconfig
```kconfig
# SPDX-FileCopyrightText: Copyright Nordic Semiconductor ASA
# SPDX-License-Identifier: Apache-2.0

rsource "Kconfig.uvc"
rsource "Kconfig.hub"
rsource "Kconfig.hid"
rsource "Kconfig.msc"
```

## subsys/usb/host/class/Kconfig.hid
```kconfig
# SPDX-License-Identifier: Apache-2.0

config USBH_HID_CLASS
	bool "USB HID Class driver (keyboard/mouse)"
	help
	  USB Human Interface Device (HID) Class driver for the USB host stack.
	  Supports Boot Protocol keyboards and mice connected either directly
	  to the host controller or through a hub.  Input reports are delivered
	  through a user-registered callback (see usbh_hid_register_report_cb()).

config USBH_HID_MAX_DEVICES
	int "Maximum number of HID devices supported"
	default 4
	range 1 16
	depends on USBH_HID_CLASS
	help
	  Maximum number of HID devices that can be simultaneously managed.
```

## subsys/usb/host/class/Kconfig.hub
```kconfig
# SPDX-License-Identifier: Apache-2.0

config USBH_HUB_CLASS
	bool "USB Hub Class driver [EXPERIMENTAL]"
	select EXPERIMENTAL
	help
	  USB Hub Class driver for the USB host stack. Handles hub port
	  power management, connection polling, port reset, and child
	  device enumeration.

config USBH_HUB_MAX
	int "Maximum number of USB hubs supported"
	default 1
	range 1 8
	depends on USBH_HUB_CLASS
	help
	  Maximum number of USB hubs that can be simultaneously managed.
```

## subsys/usb/host/class/Kconfig.msc
```kconfig
# SPDX-License-Identifier: Apache-2.0

config USBH_MSC_CLASS
	bool "USB Mass Storage Class driver"
	select DISK_ACCESS
	help
	  USB Mass Storage Class (MSC) driver for the USB host stack.
	  Supports Bulk-Only Transport (BOT) protocol with SCSI transparent
	  command set.  USB flash drives, external hard drives, and card
	  readers are automatically detected, enumerated, and registered
	  as disk devices accessible through the disk_access API and
	  filesystem layers (FATFS, LittleFS, etc.).

config USBH_MSC_MAX_DEVICES
	int "Maximum number of MSC devices supported"
	default 2
	range 1 8
	depends on USBH_MSC_CLASS
	help
	  Maximum number of MSC devices that can be simultaneously managed.
	  Each MSC device instance corresponds to one USBH_DEFINE_CLASS entry
	  and can bind to one USB interface at a time.

config USBH_MSC_MAX_LUNS
	int "Maximum number of LUNs per MSC device"
	default 4
	range 1 16
	depends on USBH_MSC_CLASS
	help
	  Maximum number of Logical Units (LUNs) per MSC device.
	  Most single-slot USB flash drives have 1 LUN (index 0), but
	  multi-slot card readers may expose several.

config USBH_MSC_MAX_XFER_SIZE
	int "Maximum single bulk transfer size in bytes"
	default 4096
	range 512 65536
	depends on USBH_MSC_CLASS
	help
	  Maximum payload (in bytes) of a single USB bulk transfer request.
	  Larger read/write requests are automatically split into chunks
	  of at most this size.  This bounds the size of intermediate
	  net_buf allocations.  Should be a multiple of 512 (sector size)
	  and a multiple of the bulk endpoint max packet size.
```
