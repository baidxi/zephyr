## drivers/input/Kconfig.ns2009
```kconfig
# Copyright (c) 2026 jeck chen <baidxi404629@gmail.com>
# SPDX-License-Identifier: Apache-2.0

menuconfig INPUT_NS2009
	bool "NSIWAY NS2009 resistive touchscreen controller"
	default y
	depends on DT_HAS_NSIWAY_NS2009_ENABLED
	select I2C
	select INPUT_TOUCH
	help
	  Enable driver for NSIWAY NS2009 4-wire resistive touchscreen
	  controller. This driver uses Z1 pressure detection polling
	  for touch detection without requiring the PENIRQ interrupt pin.

if INPUT_NS2009

config INPUT_NS2009_SAMPLES
	int "Number of ADC samples for median filter"
	default 3
	range 1 7
	help
	  Number of ADC samples to take for each measurement.
	  The median value is used to filter out noise.
	  Set to 1 to disable median filtering.

endif # INPUT_NS2009
```

## drivers/pinctrl/Kconfig.sun20i_d1
```kconfig
# Copyright (c) 2026
# SPDX-License-Identifier: Apache-2.0

config PINCTRL_SUN20I_D1
	bool "Allwinner D1/T113-S3 pinctrl"
	depends on DT_HAS_ALLWINNER_SUN20I_D1_PINCTRL_ENABLED
	default y
	help
	  Enable pinctrl driver for D1/T113-S3 PIO.
```

## drivers/pinctrl/Kconfig.sun8i_v3s
```kconfig
config PINCTRL_SUN8I_V3S
    bool "Allwinner SUN8I v3s SoC pin controller driver"
    default y
    depends on DT_HAS_ALLWINNER_SUN8I_V3S_PINCTRL_ENABLED
    help
      Allwinner SUN8I v3s SoC pin controller driver.
      Manages its own PIO base address via DT_INST_REG_ADDR(0),
      does not rely on the consumer device's reg parameter.
```

## drivers/pwm/Kconfig.gpio
```kconfig
config PWM_GPIO
    bool "gpio PWM Driver"
    default y
    depends on PWM
    depends on GPIO
    depends on DT_HAS_ZEPHYR_GPIO_PWM_ENABLED
```

## drivers/pwm/Kconfig.v3s
```kconfig
# Allwinner V3s PWM configuration options

# Copyright (c) 2026 jeck chen <baidxi404629@gmail.com>
# SPDX-License-Identifier: Apache-2.0

config PWM_V3S
	bool "Allwinner V3s PWM driver"
	default y
	depends on DT_HAS_ALLWINNER_SUN8I_V3S_PWM_ENABLED
	select PINCTRL
	help
	  Enable PWM driver for Allwinner V3s SoC.
	  The PWM module has 2 channels, each with a 16-bit counter
	  clocked from the internal 24 MHz oscillator.
```

## drivers/regulator/Kconfig.sun20i_d1
```kconfig
# Copyright (c) 2026 Juno (@bingpi)
# SPDX-License-Identifier: Apache-2.0

config REGULATOR_SUN20I_D1_SYS_LDO
	bool "Allwinner D1/T113 internal system LDO regulator driver"
	default y
	depends on DT_HAS_ALLWINNER_SUN20I_D1_SYSTEM_LDOS_ENABLED
	select SYSCON
	help
	  Enable support for the Allwinner D1/T113 internal system LDO
	  regulators (LDOA and LDOB) located in the SYS_CFG module at
	  register offset 0x150. These LDOs are accessed via the syscon
	  device of the parent system-control node.

	  - LDOA: 1.593V–2.007V, 32 steps (13.33mV/step)
	  - LDOB: 1.167V–2.007V, 64 steps (13.33mV/step)

config REGULATOR_SUN20I_D1_SYS_LDO_INIT_PRIORITY
	int "D1/T113 system LDO regulator init priority"
	default 75
	depends on REGULATOR_SUN20I_D1_SYS_LDO
	help
	  Init priority for the D1/T113 system LDO regulator driver.
	  Must be greater than CONFIG_SYSCON_INIT_PRIORITY (default 50)
	  since the driver depends on the syscon device being ready.
```

## drivers/reset/Kconfig.sun8i
```kconfig
# Reset controller configuration options

# Copyright (c) 2025
# SPDX-License-Identifier: Apache-2.0

config RESET_SUN8I_V3S
	bool "Allwinner Sun8i V3s reset controller driver"
	depends on DT_HAS_ALLWINNER_SUN8I_V3S_CCU_RESET_ENABLED
	default y
	help
	  Enable support for Allwinner Sun8i V3s reset controller.
	  This driver provides reset control for Sun8i V3s SoC peripherals.

config RESET_SUN8I_DE2
	bool "Allwinner DE2 CCU reset controller driver"
	depends on DT_HAS_ALLWINNER_SUN8I_DE2_RESET_ENABLED
	default y
	help
	  Enable support for Allwinner DE2 CCU reset controller.
	  This driver provides reset control for DE2 Mixer, Write-Back,
	  and Rotation modules within the Display Engine subsystem.

config RESET_SUN20I_D1
	bool "Allwinner Sun20i D1 / T113-S3 CCU reset controller driver"
	depends on DT_HAS_ALLWINNER_SUN20I_D1_CCU_RESET_ENABLED
	default y
	help
	  Enable support for the Allwinner D1 / T113-S3 CCU reset
	  controller.  This driver provides assert / deassert / toggle
	  control for the SoC's peripheral reset lines.  It is modelled
	  as a child node of the CCU clock controller and shares its
	  register bank.  Reset bits are active-low.

	  line_toggle() performs a clock-domain-synchronised reset release:
	  it enables the bus-clock gate, waits for the clock to stabilise,
	  then deasserts the reset line.  This matches the Linux 8250_dw
	  driver, which only deasserts the UART reset at probe time.
```

## drivers/rfid/Kconfig
```kconfig
# Copyright (c) 2025, juno
# SPDX-License-Identifier: Apache-2.0

config RFID
	bool "RFID drivers"
	help
	  Enable support for RFID drivers.

if RFID

source "drivers/rfid/Kconfig.mfrc522"

endif # RFID
```

## drivers/rfid/Kconfig.mfrc522
```kconfig
# Copyright (c) 2025, juno
# SPDX-License-Identifier: Apache-2.0

config RFID_MFRC522
	bool "MFRC522 RFID reader driver"
	default y if DT_HAS_NXP_MFRC522_SPI_ENABLED || DT_HAS_NXP_MFRC522_I2C_ENABLED
	depends on GPIO
	help
	  Enable MFRC522 RFID reader driver.

if RFID_MFRC522

choice MFRC522_BUS
	prompt "MFRC522 on bus"
	default RFID_MFRC522_BUS_SPI if DT_HAS_NXP_MFRC522_SPI_ENABLED
	default RFID_MFRC522_BUS_I2C if DT_HAS_NXP_MFRC522_I2C_ENABLED

config RFID_MFRC522_BUS_SPI
	bool "spi"
	depends on SPI
	depends on DT_HAS_NXP_MFRC522_SPI_ENABLED
	select RFID_MFRC522_SPI

config RFID_MFRC522_BUS_I2C
	bool "i2c"
	depends on I2C
	depends on DT_HAS_NXP_MFRC522_I2C_ENABLED
	select RFID_MFRC522_I2C

endchoice

config RFID_MFRC522_SPI
	bool
	

config RFID_MFRC522_I2C
	bool
	

config RFID_LOG_LEVEL
	int "RFID log level"
	default 3
	help
	  RFID log level.

config RFID_INIT_PRIORITY
	int "RFID init priority"
	default 90
	help
	  RFID init priority.

config RFID_MFRC522_TRIGGER
	bool "Enable MFRC522 trigger support"
	depends on RFID_MFRC522
	help
	  Enable trigger support for the MFRC522 driver.

endif # RFID_MFRC522
```

## drivers/rtc/Kconfig.sun20i_d1
```kconfig
# Copyright (c) 2026
# SPDX-License-Identifier: Apache-2.0

config RTC_SUN20I_D1
	bool "Allwinner SUN20I D1 / SUN8I T113 RTC driver"
	default y
	depends on DT_HAS_ALLWINNER_SUN20I_D1_RTC_ENABLED
	help
	  Enable RTC driver for Allwinner D1 / T113-S3 SoC.
	  This driver uses the linear-day counter mode with
	  comparator-based alarm (RTC_LINEAR_DAY in Linux terms).
```

## drivers/rtc/Kconfig.sun8i_v3s
```kconfig
# Copyright (c) 2026 jeck chen <baidxi404629@gmail.com>
# SPDX-License-Identifier: Apache-2.0

config RTC_SUN8I_V3S
	bool "Allwinner SUN8I V3s RTC driver"
	default y
	depends on DT_HAS_ALLWINNER_SUN8I_V3_RTC_ENABLED
	help
	  Enable RTC driver for Allwinner SUN8I V3s SoC.
	  This driver supports the on-chip RTC with date/time and
	  countdown alarm functionality.
```

## drivers/sdhc/Kconfig.sunxi
```kconfig
# Copyright (c) 2026 jeck chen <baidxi404629@gmail.com>
# SPDX-License-Identifier: Apache-2.0

config SDHC_SUNXI
	bool "Allwinner Sunxi SDHC driver"
	default y
	depends on DT_HAS_ALLWINNER_SUNXI_MMC_ENABLED || DT_HAS_ALLWINNER_SUN20I_D1_MMC_ENABLED
	select SDHC_SUPPORTS_NATIVE_MODE
	help
	  SDHC driver for Allwinner SoCs. Supports MMC/SD/SDIO cards
	  with 1/4-bit bus width, internal DMA, and card detection.

config SDHC_SUNXI_DMA
	bool "Use IDMAC DMA for data transfers"
	default y
	depends on SDHC_SUNXI
	help
	  Enable IDMAC (Internal DMA Controller) for data transfers.
	  The IDMAC engine automatically moves data between RAM and
	  the SDHC FIFO via descriptor chains, freeing the CPU from
	  PIO polling.  When disabled, PIO mode is used instead.

config SDHC_SUNXI_DMA_BUF_SIZE
	int "DMA bounce buffer size in bytes"
	default 65536
	depends on SDHC_SUNXI_DMA
	help
	  Size of the DMA bounce buffer used for data transfers.
	  Must be at least as large as the maximum single request.
	  Default 64KB matches the maximum single-descriptor size.

config SDHC_SUNXI_T113
	bool "T113/D1 SMHC variant support (extended FIFO, delay registers)"
	default y
	depends on DT_HAS_ALLWINNER_SUN20I_D1_MMC_ENABLED
	help
	  Enable support for the Allwinner T113-S3 / D1 SMHC controller.
	  This selects the T113-compatible register layout in sunxi_mmc_regs
	  (256-deep FIFO, THLD/SFC/delay registers) while keeping the V3s
	  layout bit-for-bit identical when CONFIG_SDHC_SUNXI_T113 is unset.
```

## drivers/sensor/conntek/kth7823/Kconfig
```kconfig
config KTH7823
	bool "KTH7823 Hall-effect angle sensor"
	depends on DT_HAS_CONNTEK_KTH7823_ENABLED
	depends on SPI
	help
	  Enable driver for the KTH7823 Hall-effect angle sensor.

if KTH7823

choice KTH7823_INTERFACE
	prompt "Sensor Interface"
	default KTH7823_INTERFACE_SPI
	help
	  Select the interface used to read the angle from the sensor.

config KTH7823_INTERFACE_SPI
	bool "SPI"
	help
	  Use the SPI interface to read the angle.

config KTH7823_INTERFACE_SSI
	bool "SSI"
	depends on GPIO
	help
	  Use the SSI interface to read the angle.

config KTH7823_INTERFACE_PWM
	bool "PWM"
	depends on PWM
	help
	  Use the PWM interface to read the angle.

config KTH7823_INTERFACE_ABZ
	bool "ABZ"
	depends on DT_HAS_GPIO_QDEC_ENABLED
	help
	  Select this if you intend to use the ABZ incremental encoder
	  output as the primary source of angle information.
	  Note that the standard sensor_sample_fetch() API is NOT
	  supported for this mode. You must use a separate QDEC driver
	  instance that takes the a-gpios, b-gpios, and z-gpios
	  properties from this device's devicetree node. This driver
	  will configure the GPIOs as inputs for the QDEC to use.

endchoice

config KTH7823_ABZ
	bool "Enable ABZ interface configuration (GPIO QDEC)"
	default y if KTH7823_INTERFACE_ABZ
	help
	  Enable configuration of the ABZ incremental encoder interface.
	  This is independent of the reading interface and is always done via SPI.

endif # KTH7823
```

## drivers/sensor/qst/Kconfig
```kconfig
# QST 6D Inertial Measurement Unit with Motion Co-Processor
#
# Copyright (c) 2021, juno
# SPDX-License-Identifier: Apache-2.0
#

# zephyr-keep-sorted-start
source "drivers/sensor/qst/qmi8658/Kconfig"
# zephyr-keep-sorted-stop
```

## drivers/sensor/qst/qmi8658/Kconfig
```kconfig
# Copyright (c) 2025, juno
# SPDX-License-Identifier: Apache-2.0

config QMI8658
	bool "QST QMI8658 6-Axis IMU driver"
	default y
	depends on DT_HAS_QST_QMI8658_ENABLED
	select I2C
	help
      Enable QST QMI8658 6-Axis IMU driver
```

## drivers/spi/Kconfig.sun8i_v3s
```kconfig
# Copyright (c) 2026 jeck chen <baidxi404629@gmail.com>
# SPDX-License-Identifier: Apache-2.0

config SPI_SUN8I_V3S
	bool "Allwinner sun8i V3s SPI driver"
	default y
	depends on DT_HAS_ALLWINNER_SUN8I_V3S_SPI_ENABLED
	help
	  Enable Allwinner sun8i V3s SPI driver.

config SPI_SUN8I_V3S_DMA
	bool "Enable DMA-driven transfer support"
	default y
	depends on SPI_SUN8I_V3S
	depends on DMA_SUN8I_V3S
	help
	  Enable DMA for SPI transfers instead of PIO. When enabled, the
	  driver configures DMA channels for TX (MEMORY_TO_PERIPHERAL)
	  and RX (PERIPHERAL_TO_MEMORY) using the SPI0 DRQ port 23.
	  DMA mode eliminates CPU polling/interrupt overhead for large
	  transfers. Falls back to PIO mode for small transfers below
	  the DMA threshold.
```

## drivers/usb/common/musb/Kconfig
```kconfig
# Copyright (c) 2026 jeck chen  <baidxi404629@gmail.com>
# SPDX-License-Identifier: Apache-2.0

rsource "glue/Kconfig"

config MUSB
	bool "MUSB USB controller driver core"
	help
	  Mentor Graphics MUSB USB controller driver core.
	  Provides hardware abstraction for MUSB HDRC controllers,
	  shared between UDC (device) and UHC (host) modes.

if MUSB

# NOTE: Do NOT manually define MUSB_LOG_LEVEL as an int here.
# The manual "default 0" would always win over the template's choice
# defaults, freezing the level at 0 (LOG_LEVEL_NONE) and stripping all
# MUSB log output at compile time. Let the template below own it.
module = MUSB
module-str = MUSB
source "subsys/logging/Kconfig.template.log_config"

endif # MUSB
```

## drivers/usb/common/musb/glue/Kconfig
```kconfig
# Copyright (c) 2026 jeck chen  <baidxi404629@gmail.com>
# SPDX-License-Identifier: Apache-2.0

rsource "sunxi/Kconfig"
```

## drivers/usb/common/musb/glue/sunxi/Kconfig
```kconfig
# Copyright (c) 2026 jeck chen  <baidxi404629@gmail.com>
# SPDX-License-Identifier: Apache-2.0

config MUSB_GLUE_SUNXI
	bool "Allwinner Sunxi MUSB glue layer"
	default y
	depends on DT_HAS_ALLWINNER_SUN8I_V3S_MUSB_ENABLED || DT_HAS_ALLWINNER_SUN20I_D1_MUSB_ENABLED
	select MUSB
	help
	  Allwinner Sunxi MUSB glue layer.
	  Provides register mapping and platform operations for
	  Allwinner V3s/H3 SoCs.

config MUSB_SUNXI_FORCE_FULLSPEED
	bool "Force USB Full-Speed mode (disable High-Speed)"
	depends on MUSB_GLUE_SUNXI
	help
	  Forces the MUSB controller to operate at Full-Speed (12 Mbps)
	  only, skipping the HS chirp handshake.  Use this as a diagnostic
	  when debugging HS-specific EPROTO (-71) errors: if the device
	  enumerates correctly at FS with this enabled, the root cause
	  lies in the PHY high-speed calibration path rather than the
	  MUSB data path.
```

## drivers/usb/common/sunxi/Kconfig
```kconfig
# Copyright (c) 2026 jeck chen  <baidxi404629@gmail.com>
# SPDX-License-Identifier: Apache-2.0

config SUNXI_USB_COMMON
	bool
	help
	  Enable Allwinner sunxi USB common code (PHY pseudo-device drivers).
	  This option is selected by sunxi PHY drivers when appropriate.

config SUNXI_USB_PHY_SUN4I
	bool "Allwinner sun4i USB PHY driver"
	default y
	depends on DT_HAS_ALLWINNER_SUN4I_USB_PHY_ENABLED
	select SUNXI_USB_COMMON
	help
	  Allwinner sun4i USB PHY pseudo-device driver.
	  Supports sun4i through sun50i SoCs.

	  Phase 1: sun8i V3s with peripheral mode.
	  Phase 2: Multi-SoC support (H3, A64, A33, etc.).
	  Phase 3: OTG dynamic role switching.

module = SUNXI_USB_COMMON
module-str = Allwinner sunxi USB common code
source "subsys/logging/Kconfig.template.log_config"
```

## drivers/usb/udc/Kconfig.musb
```kconfig
# Copyright (c) 2026 jeck chen  <baidxi404629@gmail.com>
# SPDX-License-Identifier: Apache-2.0

config UDC_MUSB
	bool "MUSB USB device controller driver"
	depends on MUSB
	select UDC_DRIVER_HAS_HIGH_SPEED_SUPPORT
	help
	  MUSB USB device controller driver.
	  Selects UDC_DRIVER_HAS_HIGH_SPEED_SUPPORT because MUSB IP is
	  HS-capable (actual speed depends on PHY).

config UDC_MUSB_SUNXI
	bool "Allwinner Sunxi MUSB UDC"
	default y
	depends on DT_HAS_ALLWINNER_SUN8I_V3S_MUSB_ENABLED
	select UDC_MUSB
	select MUSB_GLUE_SUNXI
	help
	  Allwinner Sunxi MUSB UDC driver for V3s/H3 SoCs.
```

## drivers/usb/uhc/Kconfig.ehci
```kconfig
# Copyright (c) 2025
# SPDX-License-Identifier: Apache-2.0

config UHC_EHCI
	bool "Generic EHCI USB host controller driver"
	default y
	depends on DT_HAS_GENERIC_EHCI_ENABLED
	help
	  Generic EHCI (Enhanced Host Controller Interface) USB host
	  controller driver.  Supports any standard EHCI-compliant
	  controller.

	  Platform-specific initialization (clocks, resets, PHY) is
	  handled through Zephyr DT infrastructure.  Verify clock
	  and reset IDs in DT bindings for your SoC.
```

## drivers/usb/uhc/Kconfig.ohci
```kconfig
# Copyright (c) 2025
# SPDX-License-Identifier: Apache-2.0

config UHC_OHCI
	bool "Generic OHCI USB host controller driver"
	default y
	depends on DT_HAS_GENERIC_OHCI_ENABLED
	help
	  Generic OHCI (Open Host Controller Interface) USB host
	  controller driver.  Supports any standard OHCI-compliant
	  controller for Full-Speed and Low-Speed devices.

	  Platform-specific initialization (clocks, resets, PHY) is
	  handled through Zephyr DT infrastructure.
```
