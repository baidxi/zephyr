## dts/bindings/gpio/allwinner,sun8i-v3s-gpio.yaml
```yaml
description: Allwinner Sun8i V3s GPIO Controller

compatible: "allwinner,sun8i-v3s-gpio"

include: [gpio-controller.yaml, base.yaml]

properties:
  reg:
    required: true

  interrupts:
    required: false

  "#gpio-cells":
    const: 2

  "#interrupt-cells":
    type: int
    const: 2

gpio-cells:
  - pin
  - flags
```

## dts/bindings/gpio/ti,tca9554.yaml
```yaml
# Copyright (c) 2024 Juno
# SPDX-License-Identifier: Apache-2.0

description: TCA9554 I2C GPIO expander

compatible: "ti,tca9554"

include: [i2c-device.yaml, gpio-controller.yaml]

properties:
  reg:
    required: true

  int-gpios:
    type: phandle-array
    description: |
      Interrupt pin.

      This pin is configured as an input and an interrupt. The interrupt
      is triggered on the falling edge.

gpio-cells:
  - pin
  - flags
```

## dts/bindings/hwspinlock/allwinner,sun6i-a31-hwspinlock.yaml
```yaml
# Copyright (c) 2026 jeck chen <baidxi404629@gmail.com>
# SPDX-License-Identifier: Apache-2.0

description: |
  Allwinner SUN6I/A31 hardware spinlock controller.
  Provides 32 hardware mutexes for cross-processor synchronization
  (e.g. ARM Cortex-A7 ↔ DSP) on Allwinner SoCs including
  A31, A64, A80, A83T, H3, H5, H6, D1, D1s, T113-S3.

compatible: "allwinner,sun6i-a31-hwspinlock"

include:
  - name: base.yaml
  - name: hwspinlock-controller.yaml
  - name: reset-device.yaml

properties:
  reg:
    required: true

  clocks:
    required: true
    description: |
      AHB bus clock gate for the spinlock module.  On T113-S3/D1
      this is CLK_BUS_SPINLOCK (bus clock from the CCU).

  resets:
    required: true
    description: |
      AHB bus reset line for the spinlock module.  On T113-S3/D1
      this is RST_BUS_SPINLOCK (bus reset from the CCU).

hwlock-cells:
  - id
```

## dts/bindings/i2c/allwinner,sun20i-d1-i2c.yaml
```yaml
# Copyright (c) 2026
#
# SPDX-License-Identifier: Apache-2.0

description: Allwinner D1 / T113s3 TWI (I2C) interface
compatible: "allwinner,sun20i-d1-i2c"
include: [i2c-controller.yaml, reset-device.yaml, pinctrl-device.yaml]
properties:
  reg:
    required: true
  interrupts:
    required: true
  clocks:
    required: true
  resets:
    required: true
  pinctrl-0:
    required: true
  pinctrl-names:
    required: true
```

## dts/bindings/i2c/allwinner,sun8i-v3s-i2c.yaml
```yaml
# Copyright (c) 2026 jeck chen <baidxi404629@gmail.com>
#
# SPDX-License-Identifier: Apache-2.0

description: Allwinner sun8i V3s TWI (I2C) interface
compatible: "allwinner,sun8i-v3s-i2c"
include: [i2c-controller.yaml, reset-device.yaml, pinctrl-device.yaml]
properties:
  reg:
    required: true
  interrupts:
    required: true
  clocks:
    required: true
  resets:
    required: true
  pinctrl-0:
    required: true
  pinctrl-names:
    required: true
```

## dts/bindings/input/nsiway,ns2009.yaml
```yaml
# Copyright (c) 2026 jeck chen <baidxi404629@gmail.com>
# SPDX-License-Identifier: Apache-2.0

description: NSIWAY NS2009 4-wire resistive touchscreen controller

compatible: "nsiway,ns2009"

include: ["i2c-device.yaml", "touchscreen-common.yaml"]

properties:
  touch-threshold:
    type: int
    default: 200
    description: |
      Z1 pressure threshold for touch detection.
      When the Z1 ADC value exceeds this threshold, a touch is detected.

  poll-period-ms:
    type: int
    default: 15
    description: |
      Polling period in milliseconds for Z1 pressure detection.
      Typical values: 10-20ms (50-100Hz sampling rate).

  min-x:
    type: int
    default: 0
    description: |
      Minimum raw X ADC value for coordinate calibration.
      This value is obtained from the leftmost touch position.

  min-y:
    type: int
    default: 0
    description: |
      Minimum raw Y ADC value for coordinate calibration.
      This value is obtained from the topmost touch position.

  max-x:
    type: int
    default: 4095
    description: |
      Maximum raw X ADC value for coordinate calibration.
      This value is obtained from the rightmost touch position.

  max-y:
    type: int
    default: 4095
    description: |
      Maximum raw Y ADC value for coordinate calibration.
      This value is obtained from the bottommost touch position.

  release-timeout-ms:
    type: int
    default: 100
    description: |
      Release detection timeout in milliseconds.
      After a touch is detected, a timer is started with this period.
      On each poll where touch is still detected, the timer is rescheduled.
      When the timer expires (no touch update for this duration),
      BTN_TOUCH=0 is sent to signal finger lift.
      This provides robust release detection independent of Z1 noise.
```

## dts/bindings/phy/allwinner,sun20i-d1-usb-phy.yaml
```yaml
# Copyright (c) 2026
# SPDX-License-Identifier: Apache-2.0

description: Allwinner D1/T113-S3 USB PHY Controller

compatible: "allwinner,sun20i-d1-usb-phy"

include: [phy-controller.yaml, reset-device.yaml]

phy-cells:
  - index

properties:
  "#phy-cells":
    const: 1

  reg:
    required: true

  reg-names:
    required: true

  clocks:
    required: true

  clock-names:
    required: true

  resets:
    required: true

  reset-names:
    required: true

  dr-mode:
    type: string
    enum: ["host", "peripheral", "otg"]
    description: |
      USB dual-role mode.
      - host: Force host mode
      - peripheral: Force device/peripheral mode
      - otg: Dynamic role switch via ID pin

  phy0-dual-route:
    type: boolean
    description: |
      Indicates that PHY0 can be routed between MUSB (peripheral) and
      EHCI/OHCI (host) controllers via the OTGCTL_ROUTE_MUSB bit.

  usb0_id_det-gpios:
    type: phandle-array
    description: |
      GPIO phandle for USB OTG ID pin detection.
      If not specified, defaults to peripheral mode.

  usb0_vbus_det-gpios:
    type: phandle-array
    description: |
      GPIO phandle for USB VBUS detection.
      If not specified, defaults to VBUS always present.
```

## dts/bindings/phy/allwinner,sun4i-usb-phy.yaml
```yaml
# Copyright (c) 2026 jeck chen  <baidxi404629@gmail.com>
# SPDX-License-Identifier: Apache-2.0

description: Allwinner sun4i USB PHY Controller

compatible: "allwinner,sun4i-usb-phy"

include: [phy-controller.yaml, reset-device.yaml]

phy-cells:
  - index

properties:
  "#phy-cells":
    const: 1

  reg:
    required: true

  reg-names:
    required: true

  clocks:
    required: true

  clock-names:
    required: true

  resets:
    required: true

  reset-names:
    required: true

  dr-mode:
    type: string
    enum: ["host", "peripheral", "otg"]
    description: |
      USB dual-role mode. Phase 1 uses "peripheral" only.
      - host: Force host mode
      - peripheral: Force device/peripheral mode
      - otg: Dynamic role switch via ID pin

  phy0-dual-route:
    type: boolean
    description: |
      Indicates that PHY0 can be routed between MUSB (peripheral) and
      EHCI/OHCI (host) controllers via the OTGCTL_ROUTE_MUSB bit.
      Present on V3s, H3, A64, and similar SoCs.

  usb0_id_det-gpios:
    type: phandle-array
    description: |
      GPIO phandle for USB OTG ID pin detection.
      When the ID pin is grounded (id_det=0), the USB controller
      enters host mode. When floating/high (id_det=1), peripheral mode.
      If not specified, defaults to peripheral mode.

  usb0_vbus_det-gpios:
    type: phandle-array
    description: |
      GPIO phandle for USB VBUS detection.
      When VBUS is present (vbus_det=1), the USB peripheral can
      connect. When absent (vbus_det=0), the peripheral disconnects.
      If not specified, defaults to VBUS always present.
```

## dts/bindings/phy/st,stm32h7rs-otghs-phy.yaml
```yaml
# Copyright (c) 2025 STMicroelectronics
# SPDX-License-Identifier: Apache-2.0

description: |
    STM32H7RS series built-in USB OTG HS PHY (USBPHYC).
    This PHY is controlled through RCC registers for clock
    and power management.

compatible: "st,stm32h7rs-otghs-phy"

include: phy-controller.yaml

properties:
  "#phy-cells":
    const: 0

  clocks:
    required: true
```

## dts/bindings/pinctrl/allwinner,sun20i-d1-pinctrl.yaml
```yaml
# SPDX-License-Identifier: Apache-2.0

description: |
  Allwinner D1 / T113-S3 pin controller.

  Example:
    #include <zephyr/dt-bindings/pinctrl/allwinner,sun20i-d1-pinctrl.h>

    &pio {
        default_state {
            uart3_pins: uart3-pins {
                pinmux = <SUNXI_PINMUX(PB6, SUN8I_FUNC_UART3)>,
                         <SUNXI_PINMUX(PB7, SUN8I_FUNC_UART3)>;
            };
        };
    };

compatible: "allwinner,sun20i-d1-pinctrl"

include: base.yaml

child-binding:
  description: Pinctrl state container

  child-binding:
    description: Pin configuration group

    include:
      - name: pincfg-node.yaml
        property-allowlist:
          - input-enable
          - bias-pull-up
          - bias-pull-down
          - drive-open-drain

    properties:
      pinmux:
        required: true
        type: array
        description: Array of SUNXI_PINMUX(pin, func) values

      drive-strength:
        type: int
        enum: [0, 1, 2, 3]
        default: 2

      allwinner,pull:
        type: string
        enum: ["no_pull", "pull_up", "pull_down"]
        default: "no_pull"
```
