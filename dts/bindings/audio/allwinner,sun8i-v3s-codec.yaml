## dts/bindings/audio/allwinner,sun8i-v3s-codec.yaml
```yaml
# Copyright (c) 2026 jeck chen <baidxi404629@gmail.com>
# SPDX-License-Identifier: Apache-2.0

description: Allwinner V3s internal audio codec

compatible: "allwinner,sun8i-v3s-codec"

include: [base.yaml, pinctrl-device.yaml]

properties:
  reg:
    required: true
    description: |
      Base address and size of the audio codec digital register space.

  interrupts:
    required: true
    description: |
      Codec interrupt specifier.

  clocks:
    required: true
    description: |
      Clock specifiers for the codec:
      - Clock 0: Bus clock (CLK_BUS_CODEC) for APB register access gating
      - Clock 1: Module clock (CLK_AC_DIG) for PLL_AUDIO derived audio clock

  clock-names:
    required: true
    description: |
      Names for the clock specifiers:
      - "apb": Bus clock for register access
      - "codec": Module clock for audio processing

  resets:
    type: phandle-array
    required: true
    description: |
      Reset specifier for the codec (RST_BUS_CODEC).

  dmas:
    type: phandle-array
    required: true
    description: |
      DMA specifiers for the codec:
      - DMA 0: RX (ADC) DMA channel
      - DMA 1: TX (DAC) DMA channel

  dma-names:
    type: string-array
    required: true
    description: |
      Names for the DMA specifiers:
      - "rx": ADC DMA channel
      - "tx": DAC DMA channel

  allwinner,codec-analog-controls:
    type: phandle
    required: true
    description: |
      Phandle to the codec-analog node which provides access
      to the AC_PR_CFG analog bridge register for reading/writing
      analog control registers.
```

## dts/bindings/clock/allwinner,sun20i-d1-ccu.yaml
```yaml
# Copyright (c) 2026 jeck chen <baidxi404629@gmail.com>
# SPDX-License-Identifier: Apache-2.0

description: |
  Allwinner D1 / T113-S3 Clock Control Unit (CCU)

  The CCU manages all clocks: PLLs, bus clocks, and peripheral clocks.
  Provides clock gating, division, multiplexing, and reset control.

  Usage:
    #include <zephyr/dt-bindings/clock/sun20i-d1-ccu.h>
    uart0: uart@2500000 {
        clocks = <&ccu CLK_BUS_UART0>;
        resets = <&ccu RST_BUS_UART0>;
    };

compatible: "allwinner,sun20i-d1-ccu"

include: [clock-controller.yaml, base.yaml]

properties:
  reg:
    required: true

  clocks:
    type: phandle-array
    required: true

  clock-names:
    type: string-array
    required: true

  "#clock-cells":
    const: 1

  "#reset-cells":
    type: int
    const: 1

clock-cells:
  - clk-id
reset-cells:
  - id
```

## dts/bindings/clock/allwinner,sun8i-de2-clk.yaml
```yaml
# Copyright (c) 2026 jeck chen <baidxi404629@gmail.com>
# SPDX-License-Identifier: Apache-2.0

description: |
  Allwinner DE2 Display Engine Clock Controller.

  The DE2 CCU provides bus clock gates, module clock gates, and clock dividers
  for the Mixer, Write-Back, and Rotation modules.

  Reset control is provided by a child reset-controller node (compatible
  "allwinner,sun8i-de2-reset").

  Based on Linux kernel bindings:
  Documentation/devicetree/bindings/clock/allwinner,sun8i-a83t-de2-clk.yaml

compatible: "allwinner,sun8i-v3s-de2-clk"

include: [clock-controller.yaml, base.yaml]

properties:
  reg:
    required: true
    description: |
      Base address and size of DE2 CCU register space (0x01000000, 64KB).

  clocks:
    type: phandle-array
    required: true
    description: |
      Input clocks: bus clock (CLK_BUS_DE) and module clock (CLK_DE).

  clock-names:
    type: string-array
    required: true
    description: |
      Names of input clocks: "bus" and "mod".

  resets:
    type: phandle-array
    required: true
    description: |
      Reset specifier for the DE bus reset (RST_BUS_DE).

  "#clock-cells":
    const: 1
    description: |
      Number of cells in a clock specifier. Should contain a single cell
      with the clock ID from <dt-bindings/clock/sun8i-de2.h>.

clock-cells:
  - clk-id
```

## dts/bindings/clock/allwinner,sun8i-v3s-ccu.yaml
```yaml
# Copyright (c) 2026 jeck chen <baidxi404629@gmail.com>
# SPDX-License-Identifier: Apache-2.0

description: |
  Allwinner Sun8i V3s Clock Control Unit (CCU)

  The CCU is responsible for managing all clocks on Sun8i V3s SoC,
  including PLLs, bus clocks, and peripheral clocks. It provides
  clock gating, division, and multiplexing capabilities.

  Clock consumer nodes should reference ccu node using a phandle
  with one cell specifying clock ID.

  Usage example:

    #include <zephyr/dt-bindings/clock/allwinner,sun8i-v3s-ccu.h>

    uart0: uart@1c28000 {
        compatible = "ns16550", "snps,dw-apb-uart";
        reg = <0x01c28000 0x400>;
        reg-shift = <2>;
        clocks = <&ccu CLK_BUS_UART0>;
        status = "disabled";
    };

compatible: "allwinner,sun8i-v3s-ccu"

include: [clock-controller.yaml, base.yaml]

properties:
  reg:
    required: true
    description: |
      Base address and size of CCU register space

  clocks:
    type: phandle-array
    description: |
      Input clocks for CCU
    required: true

  clock-names:
    type: string-array
    description: |
      Names of input clocks
    required: true

  "#clock-cells":
    const: 1
    description: |
      Number of cells in a clock specifier.
      Should contain a single cell with clock ID.

  "#reset-cells":
    const: 1
    type: int
    description: |
      Number of cells in a reset specifier.

clock-cells:
  - clk-id
```

## dts/bindings/counter/allwinner,sun8i-v3s-avs.yaml
```yaml
# Copyright (c) 22026 juno <baidxi404629@gmail.com>
# SPDX-License-Identifier: Apache-2.0

description: Allwinner Sun8i V3s AVS Counter (inherits base/clocks from parent)

compatible: "allwinner,sun8i-v3s-avs"

include: base.yaml

properties:
  divisor:
    type: int
    default: 1499
    description: |
      AVS Counter clock divisor: freq = parent_clock_freq / (divisor + 1).
```

## dts/bindings/counter/allwinner,sun8i-v3s-counter.yaml
```yaml
# Copyright (c) 2026 jeck chen  <baidxi404629@gmail.com>
# SPDX-License-Identifier: Apache-2.0

description: Allwinner Sun8i V3s Counter (per-timer, 1 alarm channel)

compatible: "allwinner,sun8i-v3s-counter"

include: base.yaml

properties:
  reg:
    required: true
    description: Timer index (0, 1, or 2)

  interrupts:
    required: true

  clocks:
    type: phandle-array
    required: true
    description: Fixed-frequency reference clock

  clock-source:
    type: int
    required: true
    enum:
      - 0
      - 1
    description: |
      Clock source mux: 0=internal_div_512 (~32KHz), 1=osc24 (OSC24M)

  prescaler:
    type: int
    required: true
    enum:
      - 0
      - 1
      - 2
      - 3
      - 4
      - 5
      - 6
      - 7
    description: |
      Prescaler divider: 0 means /1, 1 means /2, 2 means /4, 3 means /8,
      4 means /16, 5 means /32, 6 means /64, 7 means /128.
```

## dts/bindings/counter/allwinner,sun8i-v3s-timer.yaml
```yaml
# Copyright (c) 2026 jeck chen  <baidxi404629@gmail.com>
# SPDX-License-Identifier: Apache-2.0

description: Allwinner Sun8i V3s Timer (parent bus node)

compatible: "allwinner,sun8i-v3s-timer"

include: base.yaml

properties:
  reg:
    required: true

  interrupts:
    required: true

  clocks:
    type: phandle-array
    required: true
    description: Fixed-frequency reference clock (typically osc24M)
```

## dts/bindings/crypto/allwinner,sun8i-v3s-crypto.yaml
```yaml
# Copyright (c) 2026 jeck chen <baidxi404629@gmail.com>
# SPDX-License-Identifier: Apache-2.0

description: |
  Allwinner sun8i V3s Crypto Engine (Security System / SS).
  Provides hardware-accelerated AES in ECB and CBC modes
  with 128/192/256-bit keys.

compatible: "allwinner,sun8i-v3s-crypto"

include:
  - name: base.yaml
  - name: reset-device.yaml

properties:
  reg:
    required: true

  interrupts:
    required: true

  clocks:
    type: phandle-array
    required: true

  clock-names:
    type: string-array
    required: true

  resets:
    required: true

  reset-names:
    type: string-array
    required: true

  dmas:
    type: phandle-array
    description: |
      Optional DMA specifiers for RX and TX. The V3s crypto engine
      uses DRQ 16 for both directions.

  dma-names:
    type: string-array
    description: |
      Required if dmas property exists. Should be "rx" and "tx".
```

## dts/bindings/display/allwinner,sun8i-de2-mixer.yaml
```yaml
# Copyright (c) 2026 jeck chen <baidxi404629@gmail.com>
# SPDX-License-Identifier: Apache-2.0

description: |
  Allwinner DE2 Mixer (Display Engine 2.0 Mixer).

  The mixer is the display compositing engine that takes frame buffers
  from DDR memory, performs layer blending and pixel format conversion,
  and outputs a pixel stream to the TCON.

  V3s has one mixer (mixer0) with 2 video layers (VI) and 1 UI layer.
  In Zephyr, only the UI layer is used for simplicity (single framebuffer
  mode).

  Based on Linux kernel bindings:
  Documentation/devicetree/bindings/display/allwinner,sun8i-a83t-de2-mixer.yaml

compatible: "allwinner,sun8i-v3s-de2-mixer"

include: [lcd-controller.yaml, reset-device.yaml]

properties:
  reg:
    required: true
    description: |
      Base address and size of Mixer register space (0x01100000, 1MB).

  clocks:
    type: phandle-array
    required: true
    description: |
      Input clocks from the DE2 clock controller:
      - CLK_BUS_MIXER0 (bus interface clock)
      - CLK_MIXER0 (module clock)

  clock-names:
    type: string-array
    required: true
    description: |
      Names of input clocks: "bus" and "mod".

  resets:
    type: phandle-array
    required: true
    description: |
      Reset specifier for the mixer (RST_MIXER0 from DE2 CCU).

  tcon:
    type: phandle
    required: true
    description: |
      Phandle to the TCON (Timing Controller) device that generates
      HSYNC/VSYNC/DCLK signals for the LCD panel.
```

## dts/bindings/display/allwinner,sun8i-v3s-tcon.yaml
```yaml
# Copyright (c) 2026 jeck chen <baidxi404629@gmail.com>
# SPDX-License-Identifier: Apache-2.0

description: |
  Allwinner V3s TCON (Timing Controller) for LCD parallel output.

  The TCON generates HSYNC, VSYNC, DE (Data Enable), and DCLK (Pixel Clock)
  signals for driving RGB parallel LCD panels.
  It receives pixel data from the DE2 Mixer.

  V3s has one TCON (tcon0) with channel 0 only, supporting RGB parallel
  output and LVDS (not used in Zephyr for now).

compatible: "allwinner,sun8i-v3s-tcon"

include: [base.yaml, reset-device.yaml, pinctrl-device.yaml]

properties:
  reg:
    type: array
    required: true
    description: |
      Base address and size of TCON register space (0x01c0c000, 4KB).

  interrupts:
    type: array
    required: true
    description: |
      TCON interrupt (GIC_SPI 86), used for VSYNC events.

  clocks:
    type: phandle-array
    required: true
    description: |
      Input clocks from the CCU:
      - CLK_BUS_TCON0 (AHB bus clock)
      - CLK_TCON0 (channel 0 pixel clock, sourced from pll-video)

  clock-names:
    type: string-array
    required: true
    description: |
      Names of input clocks: "ahb" and "tcon-ch0".

  resets:
    type: phandle-array
    required: true
    description: |
      Reset specifier for the TCON (RST_BUS_TCON0 from CCU).

  reset-names:
    type: string-array
    required: true
    description: |
      Names of reset lines: "lcd".

  reset-gpios:
    type: phandle-array
    required: false
    description: |
      Optional GPIO specifier for LCD panel backlight enable or panel reset.
      On the Lichee Zero board, PB4 is connected to LED_EN (backlight enable).
      When specified, the GPIO is configured as output and set HIGH when the
      TCON output is enabled, LOW when disabled.

child-binding:
  description: |
    Panel timing configuration child node.
    Must use compatible "zephyr,panel-timing" (defined separately).
    The TCON driver reads these timings during initialization.
```

## dts/bindings/dma/allwinner,sun20i-d1-dma.yaml
```yaml
# Copyright (c) 2026 jeck chen <baidxi404629@gmail.com>
# SPDX-License-Identifier: Apache-2.0

description: |
  Allwinner sun20i D1 / T113 DMA controller.

  The DMA controller has 16 physical channels and supports linked-list
  descriptor chaining. It sits on the MBUS and therefore requires both
  a bus clock and an mbus clock.

  DMA clients must use a single-cell specifier giving the DRQ port
  number, as defined in <dt-bindings/dma/allwinner,sun20i-d1-dma.h>:

    spi0 {
      dmas = <&dma 22>, <&dma 22>;
      dma-names = "rx", "tx";
    };

compatible: "allwinner,sun20i-d1-dma"

include: dma-controller.yaml

properties:
  "#dma-cells":
    const: 1

  reg:
    required: true

  interrupts:
    required: true

  clocks:
    required: true
    type: phandle-array

  clock-names:
    required: true
    type: string-array
    description: |
      Must contain at least "bus". When the controller has a dedicated
      MBUS clock gate, a second entry "mbus" is required.

  resets:
    required: true
    type: phandle-array

  dma-channels:
    type: int
    required: true
    const: 16
    description: Number of physical DMA channels (always 16 on D1/T113).

  dma-requests:
    type: int
    required: true
    const: 48
    description: Number of DMA request (DRQ) ports.

dma-cells:
  - channel
```

## dts/bindings/dma/allwinner,sun8i-v3s-dma.yaml
```yaml
# Copyright (c) 2026
# SPDX-License-Identifier: Apache-2.0

description: |
  Allwinner sun8i V3s DMA controller.
  The DMA controller has 8 physical channels and supports
  linked-list descriptor chaining.

  DMA clients must use a single-cell specifier giving the
  DRQ port number:
    spi0 {
      dmas = <&dma 23>, <&dma 23>;
      dma-names = "rx", "tx";
    };

compatible: "allwinner,sun8i-v3s-dma"

include: dma-controller.yaml

properties:
  "#dma-cells":
    const: 1

  reg:
    required: true

  interrupts:
    required: true

  clocks:
    required: true
    type: phandle-array

  resets:
    required: true
    type: phandle-array

dma-cells:
  - request
```

## dts/bindings/ethernet/allwinner,sun8i-v3s-emac.yaml
```yaml
# Copyright (c) 2026
# SPDX-License-Identifier: Apache-2.0

description: Allwinner Sun8i V3s EMAC Ethernet controller

compatible: "allwinner,sun8i-v3s-emac"

include: ethernet-controller.yaml

properties:
  reg:
    required: true
  interrupts:
    required: true
  clocks:
    type: phandle-array
    required: true
    description: |
      EMAC bus clock specifier. Must reference the CCU CLK_BUS_EMAC gate.
  resets:
    type: phandle-array
    required: true
    description: |
      EMAC bus reset specifier. Must reference the CCU RST_BUS_EMAC gate.
  allwinner,leds-active-low:
    type: boolean
    description: |
      EPHY LEDs are active low. When set, the LED polarity bit in the
      syscon register will be configured for active low LEDs.
  allwinner,phy-addr:
    type: int
    default: 1
    description: |
      Internal EPHY address. Default is 1.
```

## dts/bindings/ethernet/mdio/allwinner,sun8i-v3s-mdio.yaml
```yaml
# Copyright (c) 2026 jeck chen <baidxi404629@gmail.com>
# SPDX-License-Identifier: Apache-2.0

description: Allwinner Sun8i V3s EMAC MDIO controller

compatible: "allwinner,sun8i-v3s-mdio"

include:
  - name: mdio-controller.yaml

properties:
  clock-frequency:
    description: |
      MDC clock frequency. The sun8i EMAC MDIO controller derives MDC from
      the 24 MHz oscillator. The default MDC is 1.5 MHz (24 MHz / 16).
```

## dts/bindings/gpio/allwinner,sun20i-d1-gpio.yaml
```yaml
# Copyright (c) 2026 jeck chen <baidxi404629@gmail.com>
# SPDX-License-Identifier: Apache-2.0

description: Allwinner D1/T113-S3 GPIO port

compatible: "allwinner,sun20i-d1-gpio"

include: [gpio-controller.yaml, base.yaml]

properties:
  reg:
    required: true

  interrupts:
    required: false

  "#gpio-cells":
    const: 2

  "#interrupt-cells":
    type: int
    const: 2

gpio-cells:
  - pin
  - flags
```
