## dts/bindings/spi/allwinner,sun8i-v3s-spi.yaml
```yaml
# Copyright (c) 2026 jeck chen <baidxi404629@gmail.com>
# SPDX-License-Identifier: Apache-2.0

description: Allwinner sun8i V3s SPI controller

compatible: "allwinner,sun8i-v3s-spi"

include: [spi-controller.yaml, pinctrl-device.yaml, reset-device.yaml]

properties:
  reg:
    required: true

  interrupts:
    required: true

  clocks:
    required: true

  clock-names:
    required: true

  resets:
    required: true

  pinctrl-0:
    required: true

  pinctrl-names:
    required: true

  dmas:
    type: phandle-array
    description: |
      Optional TX & RX DMA specifiers. Each specifier will have a phandle
      reference to the DMA controller, the channel number, and peripheral
      trigger source.

  dma-names:
    type: string-array
    description: |
      Required if the dmas property exists. Should be "tx" and "rx"
      to match the dmas property.

  clock-frequency:
    type: int
    description: SPI source clock frequency (Hz)

  clock-source:
    type: phandle-array
    specifier-space: clock-source
    description: |
      Phandle reference to the SPI module clock source oscillator.
      Determines the parent clock for CLK_SPI0 (CCU offset 0xA0):
        <&osc24M>       — HOSC 24 MHz
        <&pll_periph0>  — PLL_PERIPH0 600 MHz (if available)
        <&pll_periph1>  — PLL_PERIPH1 600 MHz (if available)

  gpio-cs:
    type: phandle
    description: |
      When present, hardware CS (SPI_TCR.SS_SEL) is not used.
      CS control is handled via cs-gpios property (from spi-controller.yaml)
      and spi_context_cs_control(). Without this property, the driver
      uses the built-in SPI CS signals (SS0-SS3).

  allwinner,data-width:
    type: int
    default: 8
    enum:
      - 8
      - 16
      - 32
    description: |
      AHB bus access width for SPI FIFO data port (TXD/RXD).
      8: byte access, 1 FIFO entry per access (default, safest)
      16: half-word access, 2 FIFO entries per access
      32: word access, 4 FIFO entries per access (best performance)
```

## dts/bindings/usb/allwinner,sun20i-d1-musb.yaml
```yaml
# Copyright (c) 2026 jeck chen <baidxi404629@gmail.com>
# SPDX-License-Identifier: Apache-2.0

description: Allwinner D1/T113-S3 MUSB USB OTG controller

compatible: "allwinner,sun20i-d1-musb"

include: [usb-controller.yaml, reset-device.yaml]

properties:
  reg:
    required: true

  interrupts:
    required: true

  clocks:
    required: true

  resets:
    required: true

  phys:
    type: phandle-array
    required: true

  phy-names:
    type: string-array

  num-bidir-endpoints:
    type: int
    required: true
    description: Number of bidirectional endpoints including EP0
```

## dts/bindings/usb/allwinner,sun8i-v3s-musb.yaml
```yaml
# Copyright (c) 2026 jeck chen  <baidxi404629@gmail.com>
# SPDX-License-Identifier: Apache-2.0

description: Allwinner sun8i V3s MUSB USB OTG controller

compatible: "allwinner,sun8i-v3s-musb"

include: [usb-controller.yaml, reset-device.yaml]

properties:
  reg:
    required: true

  interrupts:
    required: true

  clocks:
    required: true

  resets:
    required: true

  phys:
    type: phandle-array
    required: true

  num-bidir-endpoints:
    type: int
    required: true
    description: Number of bidirectional endpoints including EP0
```

## dts/bindings/usb/generic-ehci.yaml
```yaml
# Copyright (c) 2026 jeck chen <baidxi404629@gmail.com>
# SPDX-License-Identifier: Apache-2.0

description: Generic EHCI USB Host Controller

compatible: "generic-ehci"

include: [usb-controller.yaml, reset-device.yaml]

properties:
  reg:
    required: true
    description: EHCI operational register base address and size

  interrupts:
    required: true
    description: EHCI interrupt

  clocks:
    required: true
    description: |
      Clock specifiers for the EHCI controller.
      Typical clocks: bus clock, optionally a functional clock.

  resets:
    required: true
    description: Reset specifiers for the EHCI controller.

  phys:
    type: phandle-array
    description: USB PHY phandle with index specifier

  phy-names:
    type: string-array
    description: USB PHY name (e.g. "usb")
```

## dts/bindings/usb/generic-ohci.yaml
```yaml
# Copyright (c) 2026 jeck chen <baidxi404629@gmail.com>
# SPDX-License-Identifier: Apache-2.0

description: Generic OHCI USB Host Controller

compatible: "generic-ohci"

include: [usb-controller.yaml, reset-device.yaml]

properties:
  reg:
    required: true
    description: OHCI operational register base address and size

  interrupts:
    required: true
    description: OHCI interrupt

  clocks:
    required: true
    description: |
      Clock specifiers for the OHCI controller.
      Typical clocks: bus clock and functional (48MHz) clock.

  resets:
    required: true
    description: Reset specifiers for the OHCI controller.

  phys:
    type: phandle-array
    description: USB PHY phandle with index specifier

  phy-names:
    type: string-array
    description: USB PHY name (e.g. "usb")
```

## dts/bindings/usb/st,stm32h7rs-otghs.yaml
```yaml
# Copyright (c) 2025 STMicroelectronics
# SPDX-License-Identifier: Apache-2.0

description: STM32H7RS OTG_HS DWC2 compatible controller

compatible: "st,stm32h7rs-otghs"

include: ["snps,dwc2.yaml", "pinctrl-device.yaml"]

properties:
  clocks:
    required: true

  interrupt-names:
    type: string-array

  maximum-speed:
    type: string
    description: |
      Maximum USB speed supported by the controller.

  pinctrl-0:
    required: true

  pinctrl-names:
    required: true
```

## soc/allwinner/Kconfig
```kconfig
# Copyright (c) 2025
# SPDX-License-Identifier: Apache-2.0

if SOC_FAMILY_ARM

rsource "*/Kconfig"

endif # SOC_FAMILY_ARM
```

## soc/allwinner/Kconfig.soc
```kconfig
# Copyright (c) 2025
# SPDX-License-Identifier: Apache-2.0

config SOC_SERIES_SUN8I
	bool "Allwinner Sun8i series"
	select SOC_FAMILY_ARM

config SOC_SERIES
	default "sun8i" if SOC_SERIES_SUN8I
```

## soc/allwinner/sun8i_t113s3/Kconfig
```kconfig
# Copyright (c) 2026 jeck chen <baidxi404629@gmail.com>
# SPDX-License-Identifier: Apache-2.0

config SOC_SUN8I_T113S3
	bool
	select SOC_SERIES_SUN8I
	select ARM
	select CPU_CORTEX_A7
	select ARM_ARCH_TIMER
	select SYS_CLOCK_EXISTS
	select SOC_FAMILY_ARM
	select CACHE_MANAGEMENT
	select SOC_RESET_HOOK
	select USE_SWITCH
```
