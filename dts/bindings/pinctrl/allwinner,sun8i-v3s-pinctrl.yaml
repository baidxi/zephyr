## dts/bindings/pinctrl/allwinner,sun8i-v3s-pinctrl.yaml
```yaml
# Copyright (c) 2026 jeck chen <baidxi404629@gmail.com>
# SPDX-License-Identifier: Apache-2.0

description: |
  Allwinner SUN8I-V3S pin controller.

  Pin configuration nodes are organized in state groups as children of the
  pinctrl node. Each state group (e.g., default_state) contains pin
  configuration nodes that specify a group of pins sharing the same
  configuration using the SUN8I_V3S_PINMUX(port, pin, func) macro from
  <dt-bindings/pinctrl/allwinner,sun8i-v3s-pinctrl.h>.

  Example:
    #include <dt-bindings/pinctrl/allwinner,sun8i-v3s-pinctrl.h>

    &pinctrl {
        default_state {
            uart0_pins: uart0-pins {
                pinmux = <SUN8I_V3S_PINMUX(PORT_F, 2, FUNC_PF_UART0)>,
                         <SUN8I_V3S_PINMUX(PORT_F, 4, FUNC_PF_UART0)>;
                drive-strength = <3>;
                allwinner,pull = "pull_up";
            };
        };
    };

compatible: "allwinner,sun8i-v3s-pinctrl"

include: base.yaml

child-binding:
  description: |
    Pin configuration state container for Allwinner SUN8I-V3S.

    Each state child node (e.g., default_state) groups pin configuration
    nodes that belong to the same state.

  child-binding:
    description: |
      Pin configuration node for Allwinner SUN8I-V3S.

      Each node specifies a group of pins sharing the same electrical and
      multiplexing properties.

    include:
      - name: pincfg-node.yaml
        property-allowlist:
          - input-enable
          - bias-pull-up
          - bias-pull-down
          - drive-open-drain

    properties:
      pinmux:
        required: true
        type: array
        description: |
          An array of encoded pin multiplexing values. Each element encodes
          the port number, pin number, and function select using the
          SUN8I_V3S_PINMUX(port, pin, func) macro defined in
          <dt-bindings/pinctrl/allwinner,sun8i-v3s-pinctrl.h>.

      drive-strength:
        type: int
        enum:
          - 0
          - 1
          - 2
          - 3
        default: 2
        description: |
          Drive strength level for the pins in this group.
          0 = 20mA, 1 = 10mA, 2 = 20mA (default), 3 = 30mA.
          Verify exact values in V3s datasheet.

      allwinner,pull:
        type: string
        enum:
          - "no_pull"
          - "pull_up"
          - "pull_down"
        default: "no_pull"
        description: |
          Pull configuration for the pins in this group.
```

## dts/bindings/pwm/allwinner,sun8i-v3s-pwm.yaml
```yaml
# Copyright (c) 2026 jeck chen <baidxi404629@gmail.com>
# SPDX-License-Identifier: Apache-2.0

description: Allwinner V3s PWM controller

compatible: "allwinner,sun8i-v3s-pwm"

include: [pwm-controller.yaml, pinctrl-device.yaml, base.yaml]

properties:
  reg:
    required: true

  "#pwm-cells":
    const: 2

pwm-cells:
  - channel
  # period in terms of nanoseconds
  - period
```

## dts/bindings/pwm/zephyr,gpio-pwm.yaml
```yaml
# Copyright (c) 2025 Juno
# SPDX-License-Identifier: Apache-2.0

description: |
    This binding provides a GPIO PWM

compatible: "zephyr,gpio-pwm"

include: [pwm-controller.yaml, base.yaml, pinctrl-device.yaml]

properties:
  "#pwm-cells":
    const: 2
  frequency:
    type: int
    required: true
  gpios:
    type: phandle-array
    required: true
  
pwm-cells:
  - channel
  - period
```

## dts/bindings/regulator/allwinner,sun20i-d1-system-ldos.yaml
```yaml
# SPDX-License-Identifier: Apache-2.0

description: |
  Allwinner D1/T113 internal system LDO regulators.

  These LDOs are located in the SYS_CFG (system control) module at the
  SYS_LDO_CTRL register (offset 0x150). They are accessed through the
  syscon device that is the parent of this node.

  The two LDOs provide adjustable analog voltages for the SoC:
  - LDOA: 1.593V–2.007V, 32 steps (13.33mV/step)
  - LDOB: 1.167V–2.007V, 64 steps (13.33mV/step)

  This node must be a child of a "syscon" node covering the SYS_CFG
  address range (base 0x03000000, size 0x1000).

  Example:
    system-control@3000000 {
      compatible = "syscon";
      reg = <0x03000000 0x1000>;

      system-ldos {
        compatible = "allwinner,sun20i-d1-system-ldos";

        reg_ldoa: ldoa {
          regulator-min-microvolt = <1593333>;
          regulator-max-microvolt = <2006656>;
          regulator-always-on;
        };
        reg_ldob: ldob {
          regulator-min-microvolt = <1166666>;
          regulator-max-microvolt = <2006645>;
          regulator-always-on;
        };
      };
    };

compatible: "allwinner,sun20i-d1-system-ldos"

include: base.yaml

child-binding:
  include:
    - name: regulator.yaml
      property-allowlist:
        - regulator-name
        - regulator-always-on
        - regulator-boot-on
        - regulator-min-microvolt
        - regulator-max-microvolt
        - regulator-init-microvolt
```

## dts/bindings/reset/allwinner,sun20i-d1-ccu-reset.yaml
```yaml
# Copyright (c) 2026 jeck chen <baidxi404629@gmail.com>
# SPDX-License-Identifier: Apache-2.0

description: |
  Allwinner D1 / T113-S3 Reset Controller (part of the CCU)

  The reset controller is modelled as a child node of the CCU clock
  controller.  It shares the CCU register bank and provides reset control
  (assert / deassert) for the various peripherals.

  Reset consumer nodes reference this controller with a single-cell
  phandle that carries the reset ID, e.g.:

    #include <zephyr/dt-bindings/reset/sun20i-d1-ccu.h>

    uart3: uart@2500c00 {
        resets = <&ccu_reset D1_RST_BUS_UART3>;
    };

  On Allwinner SoCs the bus reset bits are active-low: a bit value of 1
  means "deasserted" (peripheral held out of reset) while 0 means
  "asserted" (peripheral held in reset).

compatible: "allwinner,sun20i-d1-ccu-reset"

include: [reset-controller.yaml]

properties:
  "#reset-cells":
    const: 1
    description: |
      Number of cells in a reset specifier.
      Contains a single cell with the reset ID from
      <zephyr/dt-bindings/reset/sun20i-d1-ccu.h>.

reset-cells:
  - id
```

## dts/bindings/reset/allwinner,sun8i-de2-reset.yaml
```yaml
# Copyright (c) 2026
# SPDX-License-Identifier: Apache-2.0

description: |
  Allwinner DE2 Display Engine Reset Controller.

  This is the reset controller portion of the DE2 CCU. It provides
  reset lines for the Mixer, Write-Back, and Rotation modules.

  The reset register is at a fixed offset (0x08) within the DE2 CCU
  register space. The parent node's reg property provides the base address.

  Reset IDs are defined in <zephyr/dt-bindings/reset/sun8i-de2.h>:
    RST_MIXER0 = 0
    RST_MIXER1 = 1
    RST_WB     = 2
    RST_ROT    = 3

compatible: "allwinner,sun8i-de2-reset"

include: [reset-controller.yaml, base.yaml]

properties:
  "#reset-cells":
    const: 1
    description: |
      Number of cells in a reset specifier.
      Should contain a single cell with the reset ID.

reset-cells:
  - id
```

## dts/bindings/reset/allwinner,sun8i-v3s-ccu-reset.yaml
```yaml
# Copyright (c) 2026 jeck chen <baidxi404629@gmail.com>
# SPDX-License-Identifier: Apache-2.0

description: |
  Allwinner Sun8i V3s Reset Controller (part of CCU)

  The reset controller is part of the CCU and provides reset control
  for various peripherals and subsystems.

  Reset consumer nodes should reference the reset controller using a phandle
  with one cell specifying the reset ID.

  Usage example:

    #include <zephyr/dt-bindings/reset/allwinner,sun8i-v3s-ccu.h>

    uart0: uart@1c28000 {
        compatible = "ns16550", "snps,dw-apb-uart";
        reg = <0x01c28000 0x400>;
        reg-shift = <2>;
        resets = <&ccu_reset RST_BUS_UART0>;
        status = "disabled";
    };

compatible: "allwinner,sun8i-v3s-ccu-reset"

include: [reset-controller.yaml]

properties:
  "#reset-cells":
    const: 1
    description: |
      Number of cells in a reset specifier.
      Should contain a single cell with the reset ID.

reset-cells:
  - id
```

## dts/bindings/rfid/nxp,mfrc522-i2c.yaml
```yaml
# Copyright (c) 2025, juno
# SPDX-License-Identifier: Apache-2.0

description: NXP MFRC522 RFID reader over I2C

compatible: "nxp,mfrc522-i2c"

include: i2c-device.yaml

properties:
  reset-gpios:
    type: phandle-array
    required: false
    description: Reset pin
```

## dts/bindings/rfid/nxp,mfrc522-spi.yaml
```yaml
# Copyright (c) 2025, juno
# SPDX-License-Identifier: Apache-2.0

description: NXP MFRC522 RFID reader over SPI

compatible: "nxp,mfrc522-spi"

include: spi-device.yaml

properties:
  reset-gpios:
    type: phandle-array
    required: false
    description: Reset pin
  irq-gpios:
    type: phandle-array
    required: false
    description: IRQ pin
```

## dts/bindings/rng/allwinner,sun8i-v3s-rng.yaml
```yaml
# Copyright (c) 2026 jeck chen <baidxi404629@gmail.com>
# SPDX-License-Identifier: Apache-2.0

description: |
  Allwinner sun8i V3s PRNG (Pseudo Random Number Generator).
  This is a sub-block of the Crypto Engine (Security System) providing
  160-bit hardware PRNG with 175-bit seed.

compatible: "allwinner,sun8i-v3s-rng"

include: base.yaml
```

## dts/bindings/rtc/allwinner,sun20i-d1-rtc.yaml
```yaml
# Copyright (c) 2026 jeck chen <baidxi404629@gmail.com>
# SPDX-License-Identifier: Apache-2.0

description: Allwinner SUN20I D1 / SUN8I T113-S3 RTC (linear-day counter mode)

compatible: "allwinner,sun20i-d1-rtc"

include:
  - rtc.yaml
  - rtc-device.yaml

properties:
  reg:
    required: true

  interrupts:
    required: true

  clocks:
    required: false

  clock-names:
    required: false
```

## dts/bindings/rtc/allwinner,sun8i-v3-rtc.yaml
```yaml
# Copyright (c) 2026 jeck chen <baidxi404629@gmail.com>
# SPDX-License-Identifier: Apache-2.0

description: Allwinner SUN8I V3s RTC (Real-Time Clock)

compatible: "allwinner,sun8i-v3-rtc"

include:
  - rtc.yaml
  - rtc-device.yaml

properties:
  reg:
    required: true

  interrupts:
    required: true
```

## dts/bindings/sdhc/allwinner,sun20i-d1-mmc.yaml
```yaml
# Copyright (c) 2026 jeck chen <baidxi404629@gmail.com>
# SPDX-License-Identifier: Apache-2.0

description: Allwinner T113-S3 / D1 SMHC (SD/MMC Host Controller)

compatible: "allwinner,sun20i-d1-mmc"

include: [sdhc.yaml, reset-device.yaml, pinctrl-device.yaml]

properties:
  reg:
    required: true
  interrupts:
    required: true
  clocks:
    required: true
  clock-names:
    required: true
  resets:
    required: true
  reset-names:
    required: true
  bus-width:
    type: int
    default: 4
    description: Maximum bus width supported by this controller
  frequency:
    type: int
    default: 24000000
    description: |
      Desired MMC module clock output frequency from CCU (Hz).
      The CCU driver selects the appropriate clock source
      (OSC24M / PLL_PERIPH0 / PLL_PERIPH1) and N/M dividers
      to achieve the closest match. The MMC controller's CLKCR
      divider further divides this to produce the card clock:
        card_clock = frequency / (2 * (CLKCR_div + 1))
      For SD High Speed (50 MHz), use frequency = 100000000.
  cd-gpios:
    type: phandle-array
    description: Card detect GPIO
  dmas:
    type: phandle-array
    description: |
      External DMA channel (SoC DMA controller) for SD/MMC data transfer.
      Optional: when absent the controller falls back to its internal
      IDMAC engine or PIO mode. T113-S3/T113 shares one DRQ port for
      both RX and TX per SDMMC instance.
  dma-names:
    type: string-array
    description: DMA channel names, conventionally "tx-rx".
```

## dts/bindings/sdhc/allwinner,sunxi-mmc.yaml
```yaml
# Copyright (c) 2026 jeck chen <baidxi404629@gmail.com>
# SPDX-License-Identifier: Apache-2.0

description: Allwinner Sunxi MMC/SDHC controller

compatible: "allwinner,sunxi-mmc"

include: [sdhc.yaml, reset-device.yaml, pinctrl-device.yaml]

properties:
  reg:
    required: true
  interrupts:
    required: true
  clocks:
    required: true
  clock-names:
    required: true
  resets:
    required: true
  reset-names:
    required: true
  bus-width:
    type: int
    default: 4
    description: Maximum bus width supported by this controller
  frequency:
    type: int
    default: 24000000
    description: |
      Desired MMC module clock output frequency from CCU (Hz).
      The CCU driver selects the appropriate clock source
      (OSC24M / PLL_PERIPH0 / PLL_PERIPH1) and N/M dividers
      to achieve the closest match. The MMC controller's CLKCR
      divider further divides this to produce the card clock:
        card_clock = frequency / (2 * (CLKCR_div + 1))
      For SD High Speed (50 MHz), use frequency = 100000000.
  cd-gpios:
    type: phandle-array
    description: Card detect GPIO
```

## dts/bindings/sensor/conntek,kth7823.yaml
```yaml
# Copyright (c) 2024 Conntek
# SPDX-License-Identifier: Apache-2.0

description: KTH7823 Hall-effect angle sensor

compatible: "conntek,kth7823"

include: spi-device.yaml

properties:
  abz-resolution:
    type: int
    required: false
    default: 1024
    description: |
      ABZ resolution in pulses per revolution (PPR). Valid range is 1 to 1024.
      This property is only used when CONFIG_KTH7823_ABZ is enabled.

  rotation-inverse:
    type: boolean
    required: false
    description: |
      If present, inverts the rotation direction. Corresponds to the RD register.

  zero-offset:
    type: int
    required: false
    description: |
      16-bit value for the zero position offset. Corresponds to the Z register.

  mag-high-threshold:
    type: int
    required: false
    description: |
      Magnetic field high strength alarm threshold. Valid range 0-7.
      See datasheet table 13 for mapping to mT values.

  mag-low-threshold:
    type: int
    required: false
    description: |
      Magnetic field low strength alarm threshold. Valid range 0-7.
      See datasheet table 13 for mapping to mT values.

  ssck-gpios:
    type: phandle-array
    required: false
    description: |
      GPIO for the SSI clock signal. This property should only be provided
      when the SSI interface is used for reading angle data
      (CONFIG_KTH7823_INTERFACE_SSI=y).

  ssd-gpios:
    type: phandle-array
    required: false
    description: |
      GPIO for the SSI data signal. This property should only be provided
      when the SSI interface is used for reading angle data
      (CONFIG_KTH7823_INTERFACE_SSI=y).

  pwms:
    type: phandle-array
    required: false
    description: |
      PWM specifier for the PWM input. This property should only be provided
      when the PWM interface is used for reading angle data
      (CONFIG_KTH7823_INTERFACE_PWM=y).

  a-gpios:
    type: phandle-array
    required: false
    description: |
      GPIO for the ABZ 'A' signal. Required when ABZ configuration is enabled
      (CONFIG_KTH7823_ABZ=y).

  b-gpios:
    type: phandle-array
    required: false
    description: |
      GPIO for the ABZ 'B' signal. Required when ABZ configuration is enabled
      (CONFIG_KTH7823_ABZ=y).

  z-gpios:
    type: phandle-array
    required: false
    description: |
      GPIO for the ABZ 'Z' signal. Required when ABZ configuration is enabled
      (CONFIG_KTH7823_ABZ=y).
```

## dts/bindings/sensor/qst,qmi8658.yaml
```yaml
# Copyright (c) 2025, juno
# SPDX-License-Identifier: Apache-2.0

description: QST QMI8658 6-Axis IMU

compatible: "qst,qmi8658"

include: i2c-device.yaml

properties:
  int-gpios:
    type: phandle-array
    required: false
    description: Interrupt GPIO
```
