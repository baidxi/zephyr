## boards/st/stm32g030_devebox/Kconfig.stm32g030_devebox
```kconfig
# Copyright (c) 2025 Siratul Islam
# SPDX-License-Identifier: Apache-2.0

config BOARD_STM32G030_DEVEBOX
	select SOC_STM32G030XX
```

## boards/st/stm32g030_devebox/board.yml
```yaml
board:
  name: stm32g030_devebox
  full_name: STM32G030 Core Board 1.0
  vendor: st
  socs:
    - name: stm32g030xx
```

## boards/st/stm32g030_devebox/stm32g030_devebox_defconfig
```kconfig
# SPDX-License-Identifier: Apache-2.0

# Serial Drivers
# CONFIG_SERIAL=y
# CONFIG_UART_INTERRUPT_DRIVEN=y

# Enable console
# CONFIG_CONSOLE is not set
# CONFIG_UART_CONSOLE is not set

# GPIO Controller
CONFIG_GPIO=y
```

## boards/st/stm32h750b_artpi/board.yml
```yaml
board:
  name: stm32h750b_artpi
  full_name: STM32H750B artpi
  vendor: st
  socs:
    - name: stm32h750xx
```

## boards/waveshare/esp32c6_mini/board.yml
```yaml
board:
  name: esp32c6_mini
  full_name: ESP32-C6-MINI
  vendor: waveshare
  socs:
  - name: esp32c6
```

## boards/waveshare/esp32c6_mini/esp32c6_mini_hpcore_defconfig
```kconfig
# SPDX-License-Identifier: Apache-2.0

CONFIG_CONSOLE=y
CONFIG_SERIAL=y
CONFIG_UART_CONSOLE=y
CONFIG_GPIO=y
CONFIG_I2C=y
CONFIG_I2C_SHELL=y
CONFIG_SENSOR=y
CONFIG_SENSOR_SHELL=y
CONFIG_USB_DEVICE_STACK_NEXT=y
```

## boards/wks/stm32h747xi_core/Kconfig.stm32h747xi_core
```kconfig
config BOARD_STM32H747XI_CORE
  select SOC_STM32H747XX_M4 if BOARD_STM32H747XI_CORE_STM32H747XX_M4
  select SOC_STM32H747XX_M7 if BOARD_STM32H747XI_CORE_STM32H747XX_M7
```

## boards/wks/stm32h747xi_core/board.yml
```yaml
board:
  name: stm32h747xi_core
  full_name: WKS STM32H747XI CORE BOARD
  vendor: wks
  socs:
    - name: stm32h747xx
```

## drivers/audio/Kconfig.sun8i_v3s_codec
```kconfig
# Copyright (c) 2026
# SPDX-License-Identifier: Apache-2.0

config AUDIO_CODEC_SUN8I_V3S
	bool "Allwinner V3s internal audio codec"
	default y
	depends on DT_HAS_ALLWINNER_SUN8I_V3S_CODEC_ENABLED
	select CLOCK_CONTROL
	select RESET
	help
	  Enable the Allwinner V3s internal audio codec driver.
	  This codec provides stereo DAC playback and stereo ADC recording.
	  The driver currently supports DAC playback only.
```

## drivers/clock_control/Kconfig.sun8i
```kconfig
# Clock controller configuration options

# Copyright (c) 2026 jeck chen <baidxi404629@gmail.com>
# SPDX-License-Identifier: Apache-2.0

config CLOCK_CONTROL_SUN8I_V3S
	bool "Allwinner Sun8i V3s CCU clock controller driver"
	depends on DT_HAS_ALLWINNER_SUN8I_V3S_CCU_ENABLED
	default y
	help
	  Enable support for the Allwinner Sun8i V3s Clock Control Unit (CCU).
	  This driver provides clock control for the Sun8i V3s SoC,
	  including bus clock gating for peripherals.

config CLOCK_CONTROL_SUN20I_D1
	bool "Allwinner D1 / T113-S3 CCU driver"
	depends on DT_HAS_ALLWINNER_SUN20I_D1_CCU_ENABLED
	default y
	help
	  Enable support for the D1 / T113-S3 CCU (clock gating + reset control).

config CLOCK_CONTROL_SUN8I_DE2
	bool "Allwinner SUN8I DE2 display clock controller driver"
	depends on DT_HAS_ALLWINNER_SUN8I_V3S_DE2_CLK_ENABLED
	default y
	help
	  Enable the DE2 Display Engine Clock Controller driver.
	  Provides clock gates and resets for DE2 Mixer, Write-Back, and
	  Rotation modules.
```

## drivers/counter/Kconfig.sun8i_v3s_timer
```kconfig
# Copyright (c) 2026 jeck chen  <baidxi404629@gmail.com>
# SPDX-License-Identifier: Apache-2.0

config COUNTER_TIMER_SUN8I_V3S
	bool "Allwinner Sun8i V3s Timer Counter driver"
	default y
	depends on DT_HAS_ALLWINNER_SUN8I_V3S_COUNTER_ENABLED
	help
	  Enable counter driver for Allwinner Sun8i V3s Timer channels.
	  Each counter device maps to one hardware timer (Timer 0/1/2)
	  with configurable clock source and prescaler.

if COUNTER_TIMER_SUN8I_V3S

config COUNTER_AVS_SUN8I_V3S
	bool "AVS (Audio/Video Sync) Counter"
	default y
	help
	  Enable the AVS Counter device (33-bit free-running up-counter,
	  no alarm capability). Configured via the 'divisor' DT property.

endif # COUNTER_TIMER_SUN8I_V3S
```

## drivers/crypto/Kconfig.sun8i-v3s
```kconfig
# Copyright (c) 2026 jeck chen <baidxi404629@mail.com>
# SPDX-License-Identifier: Apache-2.0

config CRYPTO_SUN8I_V3S
	bool "Allwinner Sun8i V3s Crypto Engine (Security System)"
	default y
	depends on DT_HAS_ALLWINNER_SUN8I_V3S_CRYPTO_ENABLED
	help
	  Enable the Allwinner Sun8i V3s Crypto Engine driver providing
	  hardware-accelerated AES in ECB and CBC modes with
	  128/192/256-bit keys.

config CRYPTO_SUN8I_V3S_MAX_SESSION
	int "Maximum concurrent crypto sessions"
	default 2
	depends on CRYPTO_SUN8I_V3S
	help
	  Maximum number of concurrent cipher sessions.
```

## drivers/display/Kconfig.sun8i-de2
```kconfig
# Copyright (c) 2026 jeck chen <baidxi404629@gmail.com>
# SPDX-License-Identifier: Apache-2.0

config SUN8I_DE2_MIXER
	bool "Allwinner DE2 Mixer display driver"
	default y
	depends on DT_HAS_ALLWINNER_SUN8I_V3S_DE2_MIXER_ENABLED
	help
	  Enable the Allwinner DE2 Mixer display driver for V3s SoC.
	  The mixer implements the Zephyr display driver API, providing
	  framebuffer-based display output via the DE2 Mixer's UI layer.

config SUN8I_V3S_TCON
	bool "Allwinner V3s TCON driver"
	default y
	depends on DT_HAS_ALLWINNER_SUN8I_V3S_TCON_ENABLED
	help
	  Enable the Allwinner V3s TCON (Timing Controller) driver.
	  The TCON generates HSYNC/VSYNC/DE/DCLK signals for RGB LCD panels.
```

## drivers/dma/Kconfig.sun8i_v3s
```kconfig
# Allwinner sun8i V3s DMA configuration options

# Copyright (c) 2026 jeck chen <baidxi404629@gmail.com>
# SPDX-License-Identifier: Apache-2.0

config DMA_SUN8I_V3S
	bool "Allwinner sun6i-family DMA driver (sun8i V3s / sun20i D1)"
	default y
	depends on DT_HAS_ALLWINNER_SUN8I_V3S_DMA_ENABLED || DT_HAS_ALLWINNER_SUN20I_D1_DMA_ENABLED
	select CACHE_MANAGEMENT
	select DCACHE
	help
	  DMA driver for the Allwinner sun6i DMA engine family. This is a
	  single driver shared across multiple SoCs that differ only in
	  register layout and feature set, selected at runtime via a variant
	  descriptor:

	  - sun8i V3s: 8 physical channels, 23 DRQ ports, A31-style CFG
	    register layout (5-bit DRQ), single IRQ register group.
	  - sun20i D1 / T113: 16 physical channels, 48 DRQ ports, H6-style
	    CFG register layout (6-bit DRQ), dual IRQ register groups, 34-bit
	    addressing, and an additional MBUS clock.

	  Both variants use linked-list descriptor chaining.

if DMA_SUN8I_V3S

config DMA_SUN8I_V3S_VCHAN_COUNT
	int "Number of virtual DMA channels"
	default 24
	help
	  Virtual channels allow peripheral drivers to queue DMA
	  requests even when all physical channels are busy.

config DMA_SUN8I_V3S_LLI_POOL_SIZE
	int "Maximum descriptors per channel"
	default 64
	help
	  Maximum number of chained descriptors (dma_block_config)
	  per transfer. Each descriptor occupies 24 bytes.

endif # DMA_SUN8I_V3S
```

## drivers/entropy/Kconfig.sun8i-v3s
```kconfig
# Copyright (c) 2026 jeck chen <baidxi404629@gmail.com>
# SPDX-License-Identifier: Apache-2.0

config ENTROPY_SUN8I_V3S
	bool "Allwinner Sun8i V3s PRNG entropy generator"
	default y
	depends on DT_HAS_ALLWINNER_SUN8I_V3S_RNG_ENABLED
	select ENTROPY_HAS_DRIVER
	help
	  Enable the Allwinner Sun8i V3s PRNG driver providing hardware
	  entropy based on the 160-bit PRNG inside the Crypto Engine
	  (Security System).

config ENTROPY_INIT_PRIORITY
	int
	default 56
	depends on ENTROPY_SUN8I_V3S
```

## drivers/ethernet/Kconfig.sun8i_v3s_emac
```kconfig
# Allwinner V3s EMAC Ethernet driver configuration options

# Copyright (c) 2026
# SPDX-License-Identifier: Apache-2.0

menuconfig ETH_SUN8I_V3S_EMAC
	bool "Allwinner V3s EMAC Ethernet driver"
	default y
	depends on DT_HAS_ALLWINNER_SUN8I_V3S_EMAC_ENABLED
	depends on NET_L2_ETHERNET
	select SYSCON
	select MDIO
	help
	  Enable Allwinner V3s EMAC Ethernet driver.
	  This driver supports the internal EPHY (10/100 MII) found on the
	  Allwinner V3s (Lichee Zero) SoC.

if ETH_SUN8I_V3S_EMAC

config ETH_SUN8I_V3S_EMAC_TX_DESC_COUNT
	int "Number of TX DMA descriptors"
	default 8
	range 2 64
	help
	  Number of transmit DMA descriptors in the ring buffer.
	  Each descriptor can hold one Ethernet frame.

config ETH_SUN8I_V3S_EMAC_RX_DESC_COUNT
	int "Number of RX DMA descriptors"
	default 8
	range 2 64
	help
	  Number of receive DMA descriptors in the ring buffer.
	  Each descriptor can hold one Ethernet frame.

endif # ETH_SUN8I_V3S_EMAC
```

## drivers/ethernet/mdio/Kconfig.sun8i_v3s
```kconfig
# Copyright (c) 2026
# SPDX-License-Identifier: Apache-2.0

config MDIO_SUN8I_V3S
	bool "Allwinner Sun8i V3s EMAC MDIO driver"
	default y
	depends on DT_HAS_ALLWINNER_SUN8I_V3S_MDIO_ENABLED
	depends on ETH_SUN8I_V3S_EMAC
	help
	  Enable MDIO support for the Allwinner Sun8i V3s EMAC controller.
	  This driver provides Clause 22 MDIO bus access through the EMAC's
	  built-in MII management registers.
```

## drivers/gpio/Kconfig.sun20i_d1
```kconfig
config GPIO_SUN20I_D1
	bool "Allwinner D1/T113-S3 GPIO"
	depends on DT_HAS_ALLWINNER_SUN20I_D1_PINCTRL_ENABLED
	default y
	help
	  Enable GPIO driver for D1/T113-S3.
```

## drivers/gpio/Kconfig.sun8i_v3s
```kconfig
config GPIO_SUN8I_V3S
  bool "GPIO Driver for Allwinner sun8i family of SoCs"
  default y
  depends on DT_HAS_ALLWINNER_SUN8I_V3S_GPIO_ENABLED
  help
    Enable GPIO driver for Allwinner SUN8I SoCs
```

## drivers/gpio/Kconfig.tca9554
```kconfig
# TCA9554 GPIO configuration options

# Copyright (c) 2024 Juno
# SPDX-License-Identifier: Apache-2.0

menuconfig GPIO_TCA9554
	bool "TCA9554 I2C GPIO chip"
	default y
	depends on DT_HAS_TI_TCA9554_ENABLED
	select I2C
	help
	  Enable driver for TCA9554 I2C GPIO chip.

if GPIO_TCA9554

config GPIO_TCA9554_INIT_PRIORITY
	int "Init priority"
	default 70
	help
	  Device driver initialization priority.

endif # GPIO_TCA9554
```

## drivers/hwspinlock/Kconfig.sun6i
```kconfig
# Allwinner SUN6I hardware spinlock configuration options

# Copyright (c) 2026
# SPDX-License-Identifier: Apache-2.0

config HWSPINLOCK_SUN6I
	bool "Allwinner SUN6I HW spinlock driver"
	default y
	depends on DT_HAS_ALLWINNER_SUN6I_A31_HWSPINLOCK_ENABLED
	help
	  Enable hardware spinlock driver for Allwinner SoCs with the
	  SUN6I/A31-compatible spinlock IP.  Provides 32 hardware locks
	  for cross-processor synchronization (e.g. ARM ↔ DSP).
```

## drivers/i2c/Kconfig.sun8i_v3s
```kconfig
# Copyright (c) 2026 jeck chen
#
# SPDX-License-Identifier: Apache-2.0

config I2C_SUN8I_V3S
	bool "Allwinner sun8i V3s / sun20i D1 TWI driver"
	default y
	depends on DT_HAS_ALLWINNER_SUN8I_V3S_I2C_ENABLED || \
		   DT_HAS_ALLWINNER_SUN20I_D1_I2C_ENABLED
	help
	  Enable the I2C driver for the TWI ports incorporated
	  in Allwinner V3s/V3 and D1/T113s3 SoCs.
```
