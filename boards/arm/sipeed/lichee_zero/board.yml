## boards/arm/sipeed/lichee_zero/board.yml
```yaml
board:
  name: lichee_zero
  full_name: Sipeed Lichee Zero
  vendor: sipeed
  socs:
  - name: sun8i_v3s
```

## boards/bingpi/m2/Kconfig.defconfig
```kconfig
# Copyright (c) 2026
# SPDX-License-Identifier: Apache-2.0

if BOARD_BINGPI_M2

config BOARD
	default "m2"

if UART_CONSOLE

config UART_NS16550_PORT_0
	bool
	default y

endif

endif
```

## boards/bingpi/m2/Kconfig.m2
```kconfig
# Copyright (c) 2026
# SPDX-License-Identifier: Apache-2.0

config BOARD_M2
	select SOC_SUN8I_T113S3
```

## boards/bingpi/m2/board.yml
```yaml
board:
  name: m2
  full_name: BingPi M2 (Allwinner T113-S3)
  vendor: bingpi
  socs:
  - name: sun8i_t113s3
```

## boards/bingpi/m2/m2_defconfig
```kconfig
CONFIG_SERIAL=y
CONFIG_CONSOLE=y
CONFIG_UART_CONSOLE=y
CONFIG_CLOCK_CONTROL=y
CONFIG_GPIO=y
CONFIG_PINCTRL=y
CONFIG_COUNTER=y
CONFIG_SOC_EARLY_INIT_HOOK=y
CONFIG_SOC_PREP_HOOK=y
CONFIG_T113_EARLY_PRINTK=y
CONFIG_DMA=y
CONFIG_RTC=y
CONFIG_SYSCON=y
CONFIG_SYSCON_GENERIC=y
CONFIG_REGULATOR=y
CONFIG_HWSPINLOCK=y
CONFIG_RESET=y
CONFIG_I2C=y
CONFIG_USBH_HUB_CLASS=y
CONFIG_SDHC=y
```

## boards/jlc/jlc_f103c8t6/Kconfig.jlc_f103c8t6
```kconfig
# Copyright (c) 2016 Open-RnD Sp. z o.o.
# SPDX-License-Identifier: Apache-2.0

config BOARD_JLC_F103C8T6
	select SOC_STM32F103X8
```

## boards/jlc/jlc_f103c8t6/board.yml
```yaml
board:
  name: jlc_f103c8t6
  full_name: JLC F103C8T6
  vendor: jlc
  socs:
    - name: stm32f103xb
```

## boards/sipeed/lichee_zero/Kconfig
```kconfig
# Copyright (c) 2025
# SPDX-License-Identifier: Apache-2.0

config BOARD_LICHEE_ZERO
	bool "Sipeed Lichee Zero"
	select SOC_SUN8I_V3S
```

## boards/sipeed/lichee_zero/Kconfig.defconfig
```kconfig
# Copyright (c) 2025
# SPDX-License-Identifier: Apache-2.0

if BOARD_LICHEE_ZERO

config BOARD
	default "lichee_zero"

if UART_CONSOLE

config UART_NS16550_PORT_0
	bool
	default y

endif

endif
```

## boards/sipeed/lichee_zero/lichee_zero_defconfig
```kconfig
# Copyright (c) 2026 jeck chen <baidxi404629@gmail.com>
# SPDX-License-Identifier: Apache-2.0

CONFIG_BOARD_LICHEE_ZERO=y

CONFIG_HEAP_MEM_POOL_SIZE=4121440

CONFIG_SERIAL=y
CONFIG_CONSOLE=y
CONFIG_UART_CONSOLE=y
CONFIG_UART_ASYNC_API=y
CONFIG_SHELL_ASYNC_API=y
CONFIG_UART_INTERRUPT_DRIVEN=y
CONFIG_CLOCK_CONTROL=y
CONFIG_RESET=y
CONFIG_GPIO=y
CONFIG_PINCTRL=y
CONFIG_LED=y
CONFIG_SOC_EARLY_INIT_HOOK=y
CONFIG_COUNTER=y
CONFIG_SPI=y
CONFIG_SPI_ASYNC=y
CONFIG_I2C=y
CONFIG_DMA=y

CONFIG_UDC_DRIVER=y
CONFIG_UDC_MUSB_SUNXI=y
CONFIG_SDHC=y
CONFIG_MMC_STACK=y
CONFIG_SDMMC_STACK=y
CONFIG_SDIO_STACK=y

CONFIG_NETWORKING=y
CONFIG_ETH_DRIVER=y
CONFIG_NET_L2_ETHERNET=y
CONFIG_NET_STATISTICS=y
CONFIG_NET_IPV4=y
CONFIG_NET_DHCPV4=y
CONFIG_NET_L2_ETHERNET_MGMT=y
CONFIG_NET_TCP=y
CONFIG_NET_TCP_KEEPALIVE=y
CONFIG_NET_CONTEXT_NET_PKT_POOL=y
CONFIG_DNS_RESOLVER=y

CONFIG_SETTINGS=y
CONFIG_SSH_SERVER=y
CONFIG_ZVFS_EVENTFD_MAX=4

CONFIG_CRYPTO=y
CONFIG_CRYPTO_INIT_PRIORITY=55
CONFIG_ENTROPY_INIT_PRIORITY=56

CONFIG_RTC=y

# Cache management for framebuffer DMA coherency (DE2 ↔ DDR)
CONFIG_CACHE_MANAGEMENT=y

CONFIG_PWM=y

CONFIG_AUDIO=y
CONFIG_AUDIO_CODEC=y
```

## boards/st/fpga_f103rb/board.yml
```yaml
board:
  name: fpga_f103rb
  full_name: FPGA F103RB
  vendor: st
  socs:
    - name: stm32f103xb
```

## boards/st/fpga_f103rb/fpga_f103rb_defconfig
```kconfig
# SPDX-License-Identifier: Apache-2.0

# enable uart driver
CONFIG_SERIAL=y
# enable console
CONFIG_CONSOLE=y
CONFIG_UART_CONSOLE=y

# enable GPIO
CONFIG_GPIO=y

CONFIG_I2C=y
CONFIG_I2C_CALLBACK=y

CONFIG_SMBUS=y
```

## boards/st/iot_stm32h743/board.yml
```yaml
board:
  name: iot_stm32h743
  full_name: STM32H743 iot Board
  vendor: st
  socs:
    - name: stm32h743xx
```

## boards/st/iot_stm32h743xi/Kconfig.iot_stm32h743xi
```kconfig
# Copyright (c) 2024 Charles Dias <charlesdias.cd@outlook.com>
# SPDX-License-Identifier: Apache-2.0

config BOARD_IOT_STM32H743XI
	select SOC_STM32H743XX
```

## boards/st/iot_stm32h743xi/board.yml
```yaml
board:
  name: iot_stm32h743xi
  full_name: STM32H743xi iot Board
  vendor: st
  socs:
    - name: stm32h743xx
```

## boards/st/iot_stm32h743xi/iot_stm32h743xi_defconfig
```kconfig
# Copyright (c) Charles Dias <charlesdias.cd@outlook.com>
# SPDX-License-Identifier: Apache-2.0

CONFIG_HEAP_MEM_POOL_SIZE=204800

# Enable MPU
CONFIG_ARM_MPU=y

# Enable HW stack protection
CONFIG_HW_STACK_PROTECTION=y

# Enable UART driver
CONFIG_SERIAL=y

# Enable console
CONFIG_CONSOLE=y
CONFIG_UART_CONSOLE=y

# Enable GPIO
CONFIG_GPIO=y

# CONFIG_PWM=y
# CONFIG_LED=y
# CONFIG_LED_PWM=y

# CONFIG_SHELL=y
CONFIG_SHELL_PROMPT_UART="stm32h743xx>"
```

## boards/st/motor_g431rb/Kconfig.defconfig
```kconfig
if BOARD_MOTOR_G431RB

config SPI_STM32_INTERRUPT
	default y
	depends on SPI

endif # BOARD_MOTOR_G431RB
```

## boards/st/motor_g431rb/board.yml
```yaml
board:
  name: motor_g431rb
  full_name: Motor G431RB
  vendor: st
  socs:
    - name: stm32g431xx
```

## boards/st/motor_g431rb/motor_g431rb_defconfig
```kconfig
# Serial Drivers
CONFIG_SERIAL=y
CONFIG_UART_INTERRUPT_DRIVEN=y

# enable console
CONFIG_CONSOLE=y
CONFIG_UART_CONSOLE=y

CONFIG_SHELL_PROMPT_UART="g431_motor:"

# GPIO Controller
# CONFIG_GPIO=y
# CONFIG_GPIO_SHELL=y
# CONFIG_SHELL=y
# CONFIG_ADC=y
# CONFIG_ADC_SHELL=y

# CONFIG_SPI=y
# CONFIG_SPI_STM32_DMA=y
# CONFIG_DISPLAY=y
# CONFIG_MIPI_DBI_SPI_3WIRE=y
# CONFIG_LED=y
# CONFIG_LED_SHELL=y

# CONFIG_PWM=y
# CONFIG_PWM_SHELL=y

# CONFIG_INPUT=y
# CONFIG_INPUT_SHELL=y

# CONFIG_SENSOR=y
# CONFIG_SENSOR_SHELL=y
```

## boards/st/motor_g474re/board.yml
```yaml
board:
  name: motor_g474re
  full_name: MOTOR G474RE
  vendor: st
  socs:
    - name: stm32g474xx
```

## boards/st/motor_g474ve/Kconfig.defconfig
```kconfig
# STM32G474RE Nucleo board configuration

# Copyright (c) 2019 STMicroelectronics.
# SPDX-License-Identifier: Apache-2.0

if BOARD_MOTOR_G474VE

config SPI_STM32_INTERRUPT
	default y
	depends on SPI

endif # BOARD_MOTOR_G474VE
```

## boards/st/motor_g474ve/board.yml
```yaml
board:
  name: motor_g474ve
  full_name: Motor G474VE
  vendor: st
  socs:
    - name: stm32g474xx
```

## boards/st/motor_g474ve/motor_g474ve_defconfig
```kconfig
CONFIG_SERIAL=y
CONFIG_GPIO=y
CONFIG_ARM_MPU=y
CONFIG_HW_STACK_PROTECTION=y
CONFIG_PWM=y
```

## boards/st/stm32g030_devebox/Kconfig.defconfig
```kconfig
# STM32G030 Core V1.0 board configuration

# Copyright (c) 2025 Siratul Islam
# SPDX-License-Identifier: Apache-2.0

if BOARD_STM32G030_DEVEBOX

config SPI_STM32_INTERRUPT
	default y
	depends on SPI

endif # BOARD_STM32G030_DEVEBOX
```
